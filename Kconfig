## Kconfig
```kconfig
# SPDX-License-Identifier: BSD-3-Clause

mainmenu "SOF $(PROJECTVERSION) Configuration"

comment "Compiler: $(CC_VERSION_TEXT)"

source "Kconfig.sof"
```

## Kconfig.sof
```kconfig
# SPDX-License-Identifier: BSD-3-Clause


config HOST_PTABLE
	bool
	default n

config COMPILER_WORKAROUND_CACHE_ATTR
	bool
	default n
	depends on XTENSA
	help
	  Select this to activate use of functions instead of macros
	  to decide whether an address is cacheable or not.
	  There is a weird optimization bug with gcc10x and gcc8.1
	  (with -O2 flags) on IMX platforms. See PR #4605.

config COMPILER_INLINE_FUNCTION_OPTION
        bool
	default y if CAVS_VERSION_2_5 || ACE
        default n
        help
          When enabled, -fno-inline-function option is not passed to compiler

config COLD_STORE_EXECUTE_DRAM
        bool "Execute and use cold data and code in DRAM"
        help
	  Non-performance critical data and code can be kept in DRAM to be
	  accessed and executed there without copying to SRAM. Select this
	  option to enable this feature to save SRAM and to speed up SRAM
	  copying of performance-critical data and code.


config COLD_STORE_EXECUTE_DEBUG
	bool "Enable checks for cold code on hot paths"
	help
	  This enables an assert_can_be_cold() check, which causes an exception
	  if called in the LL task context and assert() evaluation is enabled.

config FAST_GET
	bool "Enable simple refcounting DRAM data copier"
	default n
	help
	  Enable simple refcounting DRAM data copier for copying processing
	  module data from DRAM to SRAM when the data is needed and freeing
	  the SRAM when the data is not needed anymore. If multiple module
	  instances need the same chunk the same copy is used with reference
	  counting. Source is src/lib/fast-get.c. The option should be selected
	  on platforms, where __cold_rodata is supported.

rsource "Kconfig.xtos"

rsource "src/Kconfig"

if ZEPHYR_SOF_MODULE
	rsource "Kconfig.zephyr-log"
endif

menu "Debug"

config DEBUG
	bool "Enable debug build"
	default n
	help
	  Select for debug build

config GDB_DEBUG
	bool "GDB Stub"
	default n
	help
	  Select for GDB debugging

config DEBUG_MEMORY_USAGE_SCAN
	bool "Memory usage scan"
	default y
	help
	  It enables memory usage scan at demand in runtime.
	  This feature does not affect standard memory operations,
	  especially allocation and deallocation.

config DEBUG_IPC_COUNTERS
	bool "IPC counters"
	depends on CAVS
	depends on DEBUG
	default n
	help
	  Select for enabling tracing IPC counter in SRAM_REG mailbox

config DEBUG_IPC_TIMINGS
	bool "Enable IPC message handling time logging"
	depends on DEBUG
	default n
	help
	  Adds a logging after IPC handling before putting IPC reply
	  to send queue. The logging contains both the reply and the
	  original request message headers and the time that it took
	  to process the request in micro seconds. The value can be
	  used to collect statistics on changes in firmware response
	  times. This also disables the logging of the received
	  request on core 0 to avoid flooding the logs too much.

config SCHEDULE_LOG_CYCLE_STATISTICS
	bool "Log cycles per tick statistics for each task separately"
	default y
	help
	  Log DSP cycle usage statistics about once per second (1ms *
	  1024) for each task separately. The printed data is task's
	  meta information, average number of cycles/tick, and maximum
	  number of cycles/tick during the previous 1024 tick period.

config PERFORMANCE_COUNTERS
	bool "Performance counters"
	default n
	help
	  Enables tracing of simple performance measurements.
	  A basic use case is to measure number of platform & cpu clock ticks
	  passed between two checkpoints (init() and stamp()), for example
	  total time spent on running low latency scheduler tasks.
	  Platforms that gate cpu clock in wait-for-interrupt calls may also
	  use the stamp() macro periodically to find out how long the cpu
	  was in active/sleep state between the calls and estimate the cpu load.

config PERFORMANCE_COUNTERS_COMPONENT
	bool "Use performance counters to track component execution"
	default n
	depends on PERFORMANCE_COUNTERS
	help
	  Use performance counters to trace low-latency task execution.
	  This enables to observe average and peak execution times at
	  audio component level granularity.
	  Results are reported via logging subsystem.

config PERFORMANCE_COUNTERS_LL_TASKS
	bool "Use performance counters to track LL task execution"
	default n
	depends on PERFORMANCE_COUNTERS
	help
	  Use performance counters to trace low-latency task execution.
	  This enables to observe average and peak execution times at
	  task level granularity.
	  Results are reported via logging subsystem.

config DSP_RESIDENCY_COUNTERS
	bool "DSP residency counters"
	default n
	help
	  Enables simple DSP residency counters in SRAM_REG mailbox.
	  R0, R1, R2 are abstract states which can be used differently
	  based on platform implementation.

endmenu
```

## Kconfig.xtos
```kconfig
# SPDX-License-Identifier: BSD-3-Clause

# This file contains build options needed to support
# legacy driver code that still partially rely on XTOS
# definitions, even when used with Zephyr RTOS.
#
# When all platforms have moved over to native Zephyr
# drivers, this file can be removed

config XT_WAITI_DELAY
	bool
	default n
	help
	  LX6 Xtensa platforms may require additional delay to flush loads
	  and stores before entering WAITI.

config XT_HAVE_RESET_VECTOR_ROM
	bool
	default n
	help
	  Select if your platform has the reset vector
	  in ROM.

config XT_IRQ_MAP
	bool
	default n

config DMA_HW_LLI
	bool
	default n
	help
	  Hardware linked list is DMA feature, which allows
	  to automatically reload the next programmed linked list
	  item from memory without stopping the transfer. Without
	  it the transfer stops after every lli read and FW needs
	  to manually setup the next transfer.

	  Any platforms with hardware linked list support
	  should set this.

config DMA_SUSPEND_DRAIN
	bool
	default n
	help
	  Some platforms cannot just simple disable DMA
	  channel during the transfer, because it will
	  hang the whole DMA controller. Instead we can
	  suspend the channel and drain the FIFO in order
	  to stop the channel as soon as possible.

	  Any platforms without the ability to disable
	  the DMA channel right away should set this.

config DMA_FIFO_PARTITION
	bool
	default n
	help
	  Some platforms require to manually set DMA
	  FIFO partitions before starting any transfer.

	  Any platforms without automatic FIFO partitions
	  should set this.

config XT_INTERRUPT_LEVEL_1
	bool
	default n
	help
	  Select if the platform supports any interrupts of level 1.
	  Disabling this option allows for less memory consumption.

config XT_INTERRUPT_LEVEL_2
	bool
	default n
	help
	  Select if the platform supports any interrupts of level 2.
	  Disabling this option allows for less memory consumption.

config XT_INTERRUPT_LEVEL_3
	bool
	default n
	help
	  Select if the platform supports any interrupts of level 3.
	  Disabling this option allows for less memory consumption.

config XT_INTERRUPT_LEVEL_4
	bool
	default n
	help
	  Select if the platform supports any interrupts of level 4.
	  Disabling this option allows for less memory consumption.

config XT_INTERRUPT_LEVEL_5
	bool
	default n
	help
	  Select if the platform supports any interrupts of level 5.
	  Disabling this option allows for less memory consumption.
```

## Kconfig.xtos-build
```kconfig
# SPDX-License-Identifier: BSD-3-Clause

comment "XTOS options / compiler"

choice
	prompt "Optimization"
	default OPTIMIZE_FOR_PERFORMANCE
	help
	  Controls how compiler should optimize binary.
	  This config should affect only compiler settings and is
	  not meant to be used for conditional compilation of code.

config OPTIMIZE_FOR_PERFORMANCE
	bool "Optimize for performance"
	help
	  Apply compiler optimizations prioritizing performance.
	  It means -O2 for GCC or equivalent for other compilers.

config OPTIMIZE_FOR_SIZE
	bool "Optimize for size"
	help
	  Apply compiler optimizations prioritizing binary size.
	  It means -Os for GCC or equivalent for other compilers.

config OPTIMIZE_FOR_DEBUG
	bool "Optimize for debug"
	help
	  Apply compiler optimizations prioritizing debugging experience.
	  It means -Og for GCC or equivalent for other compilers.

config OPTIMIZE_FOR_NONE
	bool "Don't optimize"
	help
	  Apply no compiler optimizations.
	  It means -O0 for GCC or equivalent for other compilers.

endchoice

config BUILD_VM_ROM
	bool "Build VM ROM"
	default n
	help
	  Select if you want to build VM ROM
```

## Kconfig.xtos-dbg
```kconfig
config DEBUG_HEAP
	bool "Heap debug"
	default n
	help
	  Select for enable heap alloc debugging

config DEBUG_BLOCK_FREE
	bool "Blocks freeing debug"
	default n
	help
	  It enables checking if free was called multiple times on
	  already freed block of memory. Enabling this feature increases
	  number of memory writes and reads, due to checks for memory patterns
	  that may be performed on allocation and deallocation.

config DEBUG_FORCE_COHERENT_BUFFER
	bool "Force the allocator to allocate coherent buffer only"
	default n
	help
	  Select if we want to force the allocator to return coherent/uncached
	  buffer only.
	  This should be selected for debug purpose only, as accessing buffer
	  without caching it will reduce the read/write performance.
```

## Kconfig.zephyr-log
```kconfig
# SPDX-License-Identifier: BSD-3-Clause

menu "Logging"

config ZEPHYR_LOG
	bool "Enable Logging via Zephyr"
	default n
	help
	  Select for Zephyr logging support, and logging
	  via SOF will be disabled. If not selected, SOF
	  logging will be used.

choice "SOF_LOG_LEVEL_CHOICE"
	prompt "Max compiled-in log level for SOF"
	default SOF_LOG_LEVEL_INF
	depends on LOG

config SOF_LOG_LEVEL_OFF
	bool "Off"
	help
	  Set log level to off

config SOF_LOG_LEVEL_ERR
	bool "Error"
	help
	  Set log level to error

config SOF_LOG_LEVEL_WRN
	bool "Warning"
	help
	  Set log level to warning

config SOF_LOG_LEVEL_INF
	bool "Info"
	help
	  Set log level to info

config SOF_LOG_LEVEL_DBG
	bool "Debug"
	help
	  Set log level to debug

endchoice

config SOF_LOG_LEVEL
	int
	depends on LOG
	default 0 if SOF_LOG_LEVEL_OFF
	default 1 if SOF_LOG_LEVEL_ERR
	default 2 if SOF_LOG_LEVEL_WRN
	default 3 if SOF_LOG_LEVEL_INF
	default 4 if SOF_LOG_LEVEL_DBG

config SOF_LOG_DBG_BUFFER
	bool "Log buffer state on each consume/produce call"
	default n
	help
	  Dumps buffer struct audio_stream values on each call to comp_update_buffer_consume()
	  and comp_update_buffer_produce().
	  WARNING: Produces too much log output which usually results in many log messaged been
	  dropped! Also, if selected log backend formats log messages at runtime, enabling this
	  option results in significant CPU load!

endmenu
```

## app/boards/acp_6_0_adsp.conf
```kconfig
CONFIG_REMBRANDT=y
CONFIG_HAVE_AGENT=n
CONFIG_DCACHE_LINE_SIZE_DETECT=n
CONFIG_DCACHE_LINE_SIZE=128
CONFIG_DYNAMIC_INTERRUPTS=y
CONFIG_SHARED_INTERRUPTS=n
CONFIG_ZEPHYR_LOG=n
CONFIG_DMA=y
CONFIG_ZEPHYR_NATIVE_DRIVERS=n
CONFIG_AMS=n
CONFIG_COMP_SRC=n
CONFIG_COMP_FIR=n
CONFIG_COMP_IIR=n
CONFIG_COMP_DCBLOCK=n
CONFIG_COMP_CROSSOVER=n
CONFIG_COMP_DRC=n
CONFIG_COMP_MULTIBAND_DRC=n
CONFIG_COMP_TONE=n
CONFIG_COMP_KPB=n
CONFIG_MAXIM_DSM=n
CONFIG_COMP_ASRC=n
CONFIG_COMP_IGO_NR=n
CONFIG_COMP_COPIER=n
CONFIG_COMP_RTNR=n
CONFIG_COMP_ARIA=n
CONFIG_COMP_BASEFW_IPC4=n
CONFIG_COMP_UP_DOWN_MIXER=n
CONFIG_COMP_TDFB=n
CONFIG_COMP_SEL=n
CONFIG_COMP_MIXER=n
CONFIG_ASRC_SUPPORT_CONVERSION_24000_TO_08000=n
CONFIG_ASRC_SUPPORT_CONVERSION_24000_TO_16000=n
CONFIG_ASRC_SUPPORT_CONVERSION_48000_TO_08000=n
CONFIG_ASRC_SUPPORT_CONVERSION_48000_TO_11025=n
CONFIG_ASRC_SUPPORT_CONVERSION_48000_TO_12000=n
CONFIG_ASRC_SUPPORT_CONVERSION_48000_TO_16000=n
CONFIG_ASRC_SUPPORT_CONVERSION_48000_TO_22050=n
CONFIG_ASRC_SUPPORT_CONVERSION_48000_TO_24000=n
CONFIG_ASRC_SUPPORT_CONVERSION_48000_TO_32000=n
CONFIG_ASRC_SUPPORT_CONVERSION_48000_TO_44100=n
```

## app/boards/acp_7_0_adsp.conf
```kconfig
CONFIG_ACP_7_0=y
CONFIG_HAVE_AGENT=n
CONFIG_DCACHE_LINE_SIZE_DETECT=n
CONFIG_DCACHE_LINE_SIZE=128
CONFIG_DYNAMIC_INTERRUPTS=y
CONFIG_SHARED_INTERRUPTS=n
CONFIG_ZEPHYR_LOG=y
CONFIG_LOG_MODE_DEFERRED=n
CONFIG_LOG_MODE_MINIMAL=y
CONFIG_DMA=y
CONFIG_DMA_DOMAIN=n
CONFIG_ZEPHYR_NATIVE_DRIVERS=y
CONFIG_INTC_AMD_ACP=y
CONFIG_DMA_AMD_ACP_HOST=y
CONFIG_DMA_AMD_ACP_SDW=y
CONFIG_DAI_AMD_SDW=y
CONFIG_AMS=n
CONFIG_WRAP_ACTUAL_POSITION=y
CONFIG_TRACE=n
CONFIG_COMP_VOLUME=y
CONFIG_COMP_SRC=n
CONFIG_COMP_FIR=n
CONFIG_COMP_IIR=n
CONFIG_COMP_DCBLOCK=n
CONFIG_COMP_CROSSOVER=n
CONFIG_COMP_DRC=n
CONFIG_COMP_MULTIBAND_DRC=n
CONFIG_COMP_TONE=n
CONFIG_COMP_KPB=n
CONFIG_MAXIM_DSM=n
CONFIG_COMP_ASRC=n
CONFIG_COMP_IGO_NR=n
CONFIG_COMP_COPIER=n
CONFIG_COMP_RTNR=n
CONFIG_COMP_ARIA=n
CONFIG_COMP_BASEFW_IPC4=n
CONFIG_COMP_UP_DOWN_MIXER=n
CONFIG_COMP_TDFB=n
CONFIG_COMP_SEL=n
CONFIG_COMP_MIXER=n
CONFIG_ASRC_SUPPORT_CONVERSION_24000_TO_08000=n
CONFIG_ASRC_SUPPORT_CONVERSION_24000_TO_16000=n
CONFIG_ASRC_SUPPORT_CONVERSION_48000_TO_08000=n
CONFIG_ASRC_SUPPORT_CONVERSION_48000_TO_11025=n
CONFIG_ASRC_SUPPORT_CONVERSION_48000_TO_12000=n
CONFIG_ASRC_SUPPORT_CONVERSION_48000_TO_16000=n
CONFIG_ASRC_SUPPORT_CONVERSION_48000_TO_22050=n
CONFIG_ASRC_SUPPORT_CONVERSION_48000_TO_24000=n
CONFIG_ASRC_SUPPORT_CONVERSION_48000_TO_32000=n
CONFIG_ASRC_SUPPORT_CONVERSION_48000_TO_44100=n
CONFIG_CORE_COUNT=1
CONFIG_FORMAT_CONVERT_HIFI3=n
```

## app/boards/imx8mp_evk_mimx8ml8_adsp.conf
```kconfig
CONFIG_IMX8M=y
CONFIG_HAVE_AGENT=n
CONFIG_FORMAT_CONVERT_HIFI3=n
CONFIG_KPB_FORCE_COPY_TYPE_NORMAL=n
CONFIG_DMA=y
CONFIG_DMA_NXP_SDMA=y
CONFIG_ZEPHYR_LOG=y
CONFIG_TRACE=n
CONFIG_SHARED_INTERRUPTS=y
CONFIG_ZEPHYR_NATIVE_DRIVERS=y
CONFIG_SAI_HAS_MCLK_CONFIG_OPTION=y
CONFIG_CLOCK_CONTROL_FIXED_RATE_CLOCK=y
```

## app/boards/imx8mp_evk_mimx8ml8_m7_ddr.conf
```kconfig
CONFIG_IMX8M_CM7=y
CONFIG_ZEPHYR_NATIVE_DRIVERS=y
CONFIG_SHARED_INTERRUPTS=y
CONFIG_CLOCK_CONTROL_FIXED_RATE_CLOCK=y
CONFIG_ROMSTART_RELOCATION_ROM=y
CONFIG_DMA_NXP_SOF_HOST_DMA_ALIGN=32
CONFIG_DMA=y
CONFIG_DMA_NXP_SDMA=y
CONFIG_DAI_NXP_SAI=y
CONFIG_SAI_HAS_MCLK_CONFIG_OPTION=y
CONFIG_COMP_ASRC=n
```

## app/boards/imx8qxp_mek_mimx8qx6_adsp.conf
```kconfig
CONFIG_IMX8X=y
CONFIG_HAVE_AGENT=n
CONFIG_FORMAT_CONVERT_HIFI3=n
CONFIG_KPB_FORCE_COPY_TYPE_NORMAL=n
CONFIG_DMA=y
CONFIG_DMA_NXP_EDMA_ENABLE_HALFMAJOR_IRQ=y
CONFIG_SHARED_INTERRUPTS=y
```

## app/boards/imx8ulp_evk_mimx8ud7_adsp.conf
```kconfig
CONFIG_IMX8ULP=y
CONFIG_HAVE_AGENT=n
CONFIG_FORMAT_CONVERT_HIFI3=n
CONFIG_KPB_FORCE_COPY_TYPE_NORMAL=n

CONFIG_ZEPHYR_LOG=y
CONFIG_TRACE=n

CONFIG_DMA=y
CONFIG_DMA_NXP_EDMA_ENABLE_HALFMAJOR_IRQ=y

# TODO: remove this from here. Should be extracted
# from DAI bespoke configuration or DTS.
CONFIG_SAI_FIFO_WORD_SIZE=2

CONFIG_ZEPHYR_NATIVE_DRIVERS=y
```

## app/boards/imx93_evk_mimx9352_a55.conf
```kconfig
#
# Copyright 2023 NXP
#
# SPDX-License-Identifier: Apache-2.0

# Enable dynamic interrupts
CONFIG_DYNAMIC_INTERRUPTS=y

CONFIG_ARM64_VA_BITS_40=y
CONFIG_ARM64_PA_BITS_40=y

CONFIG_DCACHE_LINE_SIZE_DETECT=n
CONFIG_DCACHE_LINE_SIZE=64

CONFIG_IMX93_A55=y

# DAI-related configurations
CONFIG_SAI_HAS_MCLK_CONFIG_OPTION=y
CONFIG_SAI_IMX93_ERRATA_051421=y

# DMA-related configurations
CONFIG_DMA=y
CONFIG_DMA_NXP_EDMA_ENABLE_HALFMAJOR_IRQ=y

# needed because EDMA uses same interrupt for multiple
# channels.
CONFIG_SHARED_INTERRUPTS=y

CONFIG_ZEPHYR_NATIVE_DRIVERS=y
```

## app/boards/imx95_evk_mimx9596_m7_ddr.conf
```kconfig
CONFIG_DYNAMIC_INTERRUPTS=y
CONFIG_IMX95=y

CONFIG_SAI_HAS_MCLK_CONFIG_OPTION=y

CONFIG_DMA=y
CONFIG_DMA_NXP_EDMA_ENABLE_HALFMAJOR_IRQ=y
CONFIG_DMA_NXP_EDMA_ALIGN=32
CONFIG_DMA_NXP_SOF_HOST_DMA_ALIGN=32

CONFIG_SHARED_INTERRUPTS=y
```
