## app/boards/intel_adsp/Kconfig.defconfig
```kconfig
# Common defaults for all Intel ADSP SOF targets
#
# SPDX-License-Identifier: BSD-3-Clause

# ---
# NOTICE! defconfig files cannot override settings that already have
#         a default set. Thus some settings (especially choice values with
#         a default), must be set in the board config files even if the value
#         is same for all Intel DSPs.
# ---

# SOF / IPC configuration
# -----------------------

config IPC4_BASE_FW_INTEL
	default y

# SOF / audio pipeline and module settings
# ----------------------------------------

config COMP_CHAIN_DMA
	default y

config COMP_KPB
	default y

config COMP_UP_DOWN_MIXER
	default y

config FAST_GET
	default y

config FORMAT_A_LAW
	default y

config FORMAT_FLOAT
	default y

config FORMAT_MU_LAW
	default y

config FORMAT_U8
	default y

config PCM_CONVERTER_FORMAT_A_LAW
	default y

config PCM_CONVERTER_FORMAT_FLOAT
	default y

config PCM_CONVERTER_FORMAT_MU_LAW
	default y

config PCM_CONVERTER_FORMAT_S16_C16_AND_S16_C32
	default y

config PCM_CONVERTER_FORMAT_S16_C32_AND_S24_C32
	default y

config PCM_CONVERTER_FORMAT_S16_C32_AND_S32_C32
	default y

config PCM_CONVERTER_FORMAT_S16_C32_AND_S16_C32
	default y

config PCM_CONVERTER_FORMAT_S24_C24_AND_S24_C32
	default y

config PCM_CONVERTER_FORMAT_S24_C32_AND_S24_C24
	default y

config PCM_CONVERTER_FORMAT_U8
	default y

config PIPELINE_2_0
	default y

# SOF / infrastructure
# ----------------------------------------

config L3_HEAP
	default y if ACE

config ZEPHYR_DP_SCHEDULER
	default y

config ZEPHYR_NATIVE_DRIVERS
	default y

# SOF / logging
# ----------------------------------------

config ZEPHYR_LOG
	default y

# Zephyr / device drivers
# ----------------------------------------

config CLOCK_CONTROL
	default y

# note: CONFIG_CLOCK_CONTROL_ADSP is enabled by default
# based on DT definition.

config DAI
	default y

config DAI_INTEL_DMIC
	default y

config DAI_INTEL_SSP
	default y

config INTEL_ADSP_IPC
	default y

config INTEL_ADSP_TIMER
	default y

config MM_DRV
	default y


# # Zephyr / power settings
# ----------------------------------------

config PM
	default y

config PM_DEVICE
	default y

config PM_DEVICE_RUNTIME
	default y

config PM_DEVICE_SYSTEM_MANAGED
	default y

config POWER_DOMAIN
	default y

# note: POWER_DOMAIN_INTEL_ADSP will be set based on DT

# Zephyr / logging
# ----------------------------------------

config LOG_BACKEND_ADSP_MTRACE
	default y

config LOG_FUNC_NAME_PREFIX_ERR
	default y

config LOG_FUNC_NAME_PREFIX_WRN
	default y

config LOG_FUNC_NAME_PREFIX_INF
	default y

config LOG_FUNC_NAME_PREFIX_DBG
	default y

config LOG_TIMESTAMP_64BIT
	default y
```

## app/boards/intel_adsp_ace15_mtpm.conf
```kconfig
CONFIG_METEORLAKE=y
CONFIG_RIMAGE_SIGNING_SCHEMA="mtl"

# SOF / IPC configuration
CONFIG_IPC_MAJOR_4=y
CONFIG_IPC4_BASE_FW_INTEL=y

# SOF / audio pipeline and module settings
CONFIG_COMP_ARIA=y
CONFIG_COMP_CHAIN_DMA=y
CONFIG_COMP_CROSSOVER=y
CONFIG_COMP_DRC=y
CONFIG_COMP_KPB=y
CONFIG_COMP_SRC_IPC4_FULL_MATRIX=y
CONFIG_COMP_SRC_LITE=y
CONFIG_COMP_MFCC=y
CONFIG_COMP_MULTIBAND_DRC=y
CONFIG_COMP_UP_DOWN_MIXER=y
CONFIG_COMP_VOLUME_WINDOWS_FADE=y
CONFIG_FORMAT_CONVERT_HIFI3=n
CONFIG_PCM_CONVERTER_FORMAT_S16_C16_AND_S16_C32=y
CONFIG_PCM_CONVERTER_FORMAT_S16_C32_AND_S32_C32=y
CONFIG_PCM_CONVERTER_FORMAT_S16_C32_AND_S24_C32=y
CONFIG_PCM_CONVERTER_FORMAT_S24_C24_AND_S24_C32=y
CONFIG_PCM_CONVERTER_FORMAT_S24_C32_AND_S24_C24=y
CONFIG_PCM_CONVERTER_FORMAT_S16_C32_AND_S16_C32=y
CONFIG_PIPELINE_2_0=y
CONFIG_SAMPLE_KEYPHRASE=y

# SOF / audio modules / mocks
# This mock is part of official sof-bin releases because the CI that
# tests it can't use extra CONFIGs. See #9410, #8722 and #9386
CONFIG_COMP_GOOGLE_RTC_AUDIO_PROCESSING=y
CONFIG_GOOGLE_RTC_AUDIO_PROCESSING_MOCK=y

# SOF / infrastructure
CONFIG_AMS=y
CONFIG_COUNTER=y
CONFIG_KCPS_DYNAMIC_CLOCK_CONTROL=y
CONFIG_L3_HEAP=y
CONFIG_LL_WATCHDOG=y
CONFIG_PROBE=y
CONFIG_PROBE_DMA_MAX=2
CONFIG_SOF_TELEMETRY=y
CONFIG_SOF_TELEMETRY_IO_PERFORMANCE_MEASUREMENTS=y
CONFIG_SOF_TELEMETRY_PERFORMANCE_MEASUREMENTS=y
CONFIG_ZEPHYR_NATIVE_DRIVERS=y
CONFIG_ZEPHYR_DP_SCHEDULER=y
CONFIG_COLD_STORE_EXECUTE_DRAM=y

# SOF / loadable modules
CONFIG_INTEL_MODULES=y
CONFIG_LIBRARY_MANAGER=y
CONFIG_LIBRARY_AUTH_SUPPORT=y
CONFIG_LIBRARY_BASE_ADDRESS=0xa0688000
CONFIG_LIBRARY_BUILD_LIB=y

# SOF / logging
CONFIG_SOF_LOG_LEVEL_INF=y

# Zephyr / OS features
CONFIG_DEBUG_COREDUMP=y
CONFIG_DEBUG_COREDUMP_BACKEND_INTEL_ADSP_MEM_WINDOW=y
CONFIG_DEBUG_COREDUMP_MEMORY_DUMP_MIN=y
CONFIG_HEAP_MEM_POOL_SIZE=8192
CONFIG_LLEXT=y
CONFIG_LLEXT_STORAGE_WRITABLE=y
CONFIG_MODULES=y
CONFIG_TIMING_FUNCTIONS=y
CONFIG_WATCHDOG=y

# Zephyr / device drivers
CONFIG_CLOCK_CONTROL=y
CONFIG_CLOCK_CONTROL_ADSP=y
CONFIG_DAI=y
CONFIG_DAI_DMIC_HAS_OWNERSHIP=y
CONFIG_DAI_DMIC_HAS_MULTIPLE_LINE_SYNC=y
CONFIG_DAI_DMIC_HW_IOCLK=38400000
CONFIG_DAI_INIT_PRIORITY=70
CONFIG_DAI_INTEL_DMIC=y
CONFIG_DAI_INTEL_DMIC_NHLT=y
CONFIG_DAI_INTEL_SSP=y
CONFIG_DMA=y
CONFIG_DMA_DW_LLI_POOL_SIZE=50
CONFIG_DMA_INTEL_ADSP_GPDMA=y
CONFIG_INTEL_ADSP_IPC=y
CONFIG_INTEL_ADSP_TIMER=y
CONFIG_MEMORY_WIN_2_SIZE=12288
CONFIG_MM_DRV_INTEL_ADSP_TLB_REMAP_UNUSED_RAM=y
CONFIG_SYS_CLOCK_HW_CYCLES_PER_SEC=38400000
CONFIG_SYS_CLOCK_TICKS_PER_SEC=12000

# Zephyr / power settings
CONFIG_ADSP_IDLE_CLOCK_GATING=y
CONFIG_ADSP_IMR_CONTEXT_SAVE=n
CONFIG_PM=y
CONFIG_PM_DEVICE=y
CONFIG_PM_DEVICE_RUNTIME=y
CONFIG_PM_DEVICE_SYSTEM_MANAGED=y
CONFIG_PM_DEVICE_POWER_DOMAIN=y
CONFIG_PM_POLICY_CUSTOM=y
CONFIG_POWER_DOMAIN=y
CONFIG_POWER_DOMAIN_INTEL_ADSP=y

# Zephyr / logging

CONFIG_LOG_BACKEND_ADSP=n
CONFIG_LOG_BACKEND_ADSP_MTRACE=y
CONFIG_LOG_BACKEND_SOF_PROBE=n
CONFIG_LOG_FUNC_NAME_PREFIX_ERR=y
CONFIG_LOG_FUNC_NAME_PREFIX_WRN=y
CONFIG_LOG_FUNC_NAME_PREFIX_INF=y
CONFIG_LOG_FUNC_NAME_PREFIX_DBG=y
CONFIG_LOG_OUTPUT_FORMAT_LINUX_TIMESTAMP=y
CONFIG_LOG_TIMESTAMP_64BIT=y
CONFIG_WINSTREAM_CONSOLE=n
```

## app/boards/intel_adsp_ace30_ptl_llvm_qemu.conf
```kconfig
# LLVM Single-Core QEMU Testing Configuration
# Base: intel_adsp_ace30_ptl.conf (applied automatically by board name)
# Purpose: Override settings for single-core LLVM QEMU testing
#
# This config is applied ON TOP of the base intel_adsp_ace30_ptl.conf
# via -DEXTRA_CONF_FILE= to the build system.

# ---- Single core for QEMU (no SMP hangs) ----
CONFIG_CORE_COUNT=1
CONFIG_SMP=n
CONFIG_EVENTS=y

# ---- Disable LLEXT/loadable modules (missing TIE headers in LLVM) ----
CONFIG_LLEXT=n
CONFIG_LIBRARY_MANAGER=n
CONFIG_INTEL_MODULES=n
CONFIG_LIBRARY_AUTH_SUPPORT=n
CONFIG_LIBRARY_BUILD_LIB=n
CONFIG_LIBRARY_DEFAULT_MODULAR=n

# ---- Disable HiFi3-optimized code (missing xt_FP.h in LLVM) ----
CONFIG_FORMAT_CONVERT_HIFI3=n
CONFIG_PCM_CONVERTER_FORMAT_CONVERT_HIFI3=n

# ---- Make all modules static (since LLEXT is off) ----
CONFIG_COMP_TESTER=y
CONFIG_COMP_GOOGLE_RTC_AUDIO_PROCESSING=y

# ---- Logging: use deferred mode matching working build-ptl ----
CONFIG_LOG_MODE_DEFERRED=y

# ---- Disable userspace for simpler single-core boot ----
CONFIG_USERSPACE=n
CONFIG_DYNAMIC_THREAD=n
CONFIG_DYNAMIC_THREAD_ALLOC=n
CONFIG_SOF_USERSPACE_PROXY=n
CONFIG_MAX_THREAD_BYTES=1
CONFIG_SCHED_CPU_MASK=n
CONFIG_PM=n
CONFIG_ADSP_IMR_CONTEXT_SAVE=n
```

## app/boards/intel_adsp_ace30_ptl_sim.conf
```kconfig
CONFIG_PANTHERLAKE=y
CONFIG_IPC_MAJOR_4=y

# turn off SOF drivers
CONFIG_CORE_COUNT=5

CONFIG_ZTEST=y
CONFIG_SOF_BOOT_TEST_STANDALONE=y
CONFIG_TEST_USERSPACE=y
CONFIG_MM_DRV=y
CONFIG_ZEPHYR_NATIVE_DRIVERS=y
CONFIG_SOF_USERSPACE_LL=y

CONFIG_COMP_SRC=y

CONFIG_COMP_SRC_IPC4_FULL_MATRIX=y

# power settings
CONFIG_PM=n

# enable Zephyr drivers
CONFIG_DAI_INIT_PRIORITY=70
CONFIG_DAI_DMIC_HW_IOCLK=19200000
CONFIG_DAI_DMIC_HAS_OWNERSHIP=n
CONFIG_DAI_DMIC_HAS_MULTIPLE_LINE_SYNC=y
CONFIG_DAI_INTEL_SSP=n
CONFIG_DMA_INTEL_ADSP_GPDMA=n
CONFIG_DMA_DW_LLI_POOL_SIZE=50
CONFIG_INTEL_MODULES=n
CONFIG_LIBRARY_MANAGER=n

CONFIG_HEAP_MEM_POOL_SIZE=8192
CONFIG_RIMAGE_SIGNING_SCHEMA="ptl"

CONFIG_FORMAT_CONVERT_HIFI3=n
CONFIG_LOG=y
CONFIG_LOG_MODE_DEFERRED=n
CONFIG_LOG_FUNC_NAME_PREFIX_INF=n
CONFIG_SYS_CLOCK_TICKS_PER_SEC=12000
CONFIG_SYS_CLOCK_HW_CYCLES_PER_SEC=19200000

CONFIG_LOG_BACKEND_ADSP_MTRACE=n
CONFIG_SOF_LOG_LEVEL_INF=y
CONFIG_SOF_LOG_LEVEL_OFF=n
CONFIG_ZEPHYR_LOG=y

CONFIG_INTEL_ADSP_IPC=y


# Temporary disabled options
CONFIG_PM_DEVICE_RUNTIME=n
CONFIG_PM_DEVICE_POWER_DOMAIN=n
CONFIG_PM_PREWAKEUP_CONV_MODE_CEIL=y
CONFIG_COMP_KPB=n

CONFIG_USERSPACE=y
CONFIG_MAX_THREAD_BYTES=4

CONFIG_COMP_UP_DOWN_MIXER=y
CONFIG_COMP_MODULE_ADAPTER=y
CONFIG_PASSTHROUGH_CODEC=y
CONFIG_COMP_ARIA=y
CONFIG_COMP_MFCC=y
CONFIG_COMP_CROSSOVER=y
CONFIG_COMP_DCBLOCK=y
CONFIG_COMP_IIR=y
CONFIG_COMP_DRC=y
CONFIG_COMP_MULTIBAND_DRC=y
CONFIG_COMP_LEVEL_MULTIPLIER=y
CONFIG_COMP_RTNR=y
CONFIG_COMP_RTNR_STUB=y
CONFIG_COMP_SMART_AMP=y
CONFIG_COMP_TDFB=y
CONFIG_COMP_STFT_PROCESS=y
CONFIG_COMP_GOOGLE_RTC_AUDIO_PROCESSING=y
CONFIG_GOOGLE_RTC_AUDIO_PROCESSING_MOCK=y
CONFIG_COMP_GOOGLE_CTC_AUDIO_PROCESSING=y
CONFIG_GOOGLE_CTC_AUDIO_PROCESSING_MOCK=y
CONFIG_COMP_IGO_NR=y
CONFIG_COMP_IGO_NR_STUB=y
CONFIG_COMP_NXP_EAP=y
CONFIG_COMP_NXP_EAP_STUB=y
CONFIG_CPP=y
CONFIG_STD_CPP17=y
CONFIG_COMP_SOUND_DOSE=y
```

## app/boards/intel_adsp_ace30_wcl_sim.conf
```kconfig
CONFIG_WILDCATLAKE=y
CONFIG_IPC_MAJOR_4=y

# turn off SOF drivers
CONFIG_COMP_SRC=y

CONFIG_COMP_SRC_IPC4_FULL_MATRIX=y

# power settings
CONFIG_PM=n

# enable Zephyr drivers
CONFIG_DAI_INIT_PRIORITY=70
CONFIG_DAI_DMIC_HW_IOCLK=19200000
CONFIG_DAI_DMIC_HAS_OWNERSHIP=y
CONFIG_DAI_DMIC_HAS_MULTIPLE_LINE_SYNC=y
CONFIG_DAI_INTEL_SSP=n
CONFIG_DMA_INTEL_ADSP_GPDMA=n
CONFIG_INTEL_MODULES=n
CONFIG_LIBRARY_MANAGER=n
CONFIG_INTEL_ADSP_TIMER=y

CONFIG_HEAP_MEM_POOL_SIZE=8192
CONFIG_RIMAGE_SIGNING_SCHEMA="ptl"

CONFIG_LOG=n
CONFIG_LOG_MODE_DEFERRED=n
CONFIG_LOG_FUNC_NAME_PREFIX_INF=n
CONFIG_SYS_CLOCK_TICKS_PER_SEC=12000
CONFIG_SYS_CLOCK_HW_CYCLES_PER_SEC=19200000

CONFIG_LOG_BACKEND_ADSP_MTRACE=n
CONFIG_SOF_LOG_LEVEL_INF=n
CONFIG_SOF_LOG_LEVEL_OFF=y
CONFIG_ZEPHYR_LOG=n

# Temporary disabled options
CONFIG_PM_DEVICE_RUNTIME=n
CONFIG_PM_DEVICE_POWER_DOMAIN=n
CONFIG_PM_PREWAKEUP_CONV_MODE_CEIL=y
CONFIG_COMP_KPB=n

CONFIG_USERSPACE=y
```

## app/boards/intel_adsp_ace40_nvl.conf
```kconfig
CONFIG_NOVALAKE=y
CONFIG_RIMAGE_SIGNING_SCHEMA="nvl"

# SOF / IPC configuration
CONFIG_IPC_MAJOR_4=y

# SOF / audio pipeline and module settings
CONFIG_COMP_SRC=y
CONFIG_COMP_ARIA=y
CONFIG_COMP_DRC=y
CONFIG_COMP_SRC_IPC4_FULL_MATRIX=y
CONFIG_COMP_TESTER=y
CONFIG_FORMAT_CONVERT_HIFI3=n

# SOF / infrastructure
CONFIG_PROBE=y
CONFIG_PROBE_DMA_MAX=2
CONFIG_COLD_STORE_EXECUTE_DRAM=y

# SOF / loadable modules
CONFIG_INTEL_MODULES=y
CONFIG_LIBRARY_MANAGER=y

# SOF / logging
CONFIG_TRACE=n
CONFIG_SOF_LOG_LEVEL_INF=y

# Zephyr / OS features
CONFIG_HEAP_MEM_POOL_SIZE=8192

# Zephyr / device drivers
CONFIG_DAI_INIT_PRIORITY=70
CONFIG_DAI_DMIC_HW_IOCLK=38400000
CONFIG_DAI_DMIC_HAS_OWNERSHIP=n
CONFIG_DAI_DMIC_HAS_MULTIPLE_LINE_SYNC=y
CONFIG_DMA_INTEL_ADSP_GPDMA=n
CONFIG_MM_DRV_INTEL_ADSP_TLB_REMAP_UNUSED_RAM=y
CONFIG_SYS_CLOCK_TICKS_PER_SEC=12000

# Zephyr / power settings
CONFIG_ADSP_IMR_CONTEXT_SAVE=y
CONFIG_PM_POLICY_CUSTOM=y
CONFIG_PM_PREWAKEUP_CONV_MODE_CEIL=y
CONFIG_SRAM_RETENTION_MODE=n

# Zephyr / logging
CONFIG_LOG_BACKEND_ADSP=n
CONFIG_WINSTREAM_CONSOLE=n
```

## app/boards/intel_adsp_ace40_nvls.conf
```kconfig
CONFIG_NOVALAKE=y
CONFIG_RIMAGE_SIGNING_SCHEMA="nvl"

# SOF / IPC configuration
CONFIG_IPC_MAJOR_4=y

# SOF / audio pipeline and module settings
CONFIG_COMP_SRC=y
CONFIG_MM_DRV=y
CONFIG_COMP_ARIA=y
CONFIG_COMP_CHAIN_DMA=y
CONFIG_COMP_DRC=y
CONFIG_COMP_KPB=y
CONFIG_COMP_SRC_IPC4_FULL_MATRIX=y
CONFIG_COMP_TESTER=y
CONFIG_COMP_UP_DOWN_MIXER=y
CONFIG_COMP_VOLUME_WINDOWS_FADE=y
CONFIG_FORMAT_CONVERT_HIFI3=n

# SOF / infrastructure
CONFIG_PROBE=y
CONFIG_PROBE_DMA_MAX=2

# SOF / loadable modules
CONFIG_INTEL_MODULES=y
CONFIG_LIBRARY_MANAGER=y

# SOF / logging
CONFIG_TRACE=n
CONFIG_SOF_LOG_LEVEL_INF=y

# Zephyr / OS features
CONFIG_HEAP_MEM_POOL_SIZE=8192

# Zephyr / device drivers
CONFIG_DAI=y
CONFIG_DAI_INIT_PRIORITY=70
CONFIG_DAI_INTEL_DMIC=y
CONFIG_DAI_DMIC_HW_IOCLK=38400000
CONFIG_DAI_INTEL_DMIC_NHLT=y
CONFIG_DAI_DMIC_HAS_OWNERSHIP=n
CONFIG_DAI_DMIC_HAS_MULTIPLE_LINE_SYNC=y
CONFIG_DAI_INTEL_SSP=y
CONFIG_DMA=y
CONFIG_DMA_INTEL_ADSP_GPDMA=n
CONFIG_INTEL_ADSP_IPC=y
CONFIG_INTEL_ADSP_TIMER=y
CONFIG_MM_DRV_INTEL_ADSP_TLB_REMAP_UNUSED_RAM=y
CONFIG_SYS_CLOCK_TICKS_PER_SEC=12000

# Zephyr / power settings
CONFIG_ADSP_IMR_CONTEXT_SAVE=y
CONFIG_PM=y
CONFIG_PM_DEVICE=y
CONFIG_PM_DEVICE_RUNTIME=y
CONFIG_PM_DEVICE_POWER_DOMAIN=y
CONFIG_PM_DEVICE_SYSTEM_MANAGED=y
CONFIG_PM_POLICY_CUSTOM=y
CONFIG_PM_PREWAKEUP_CONV_MODE_CEIL=y
CONFIG_POWER_DOMAIN=y
CONFIG_POWER_DOMAIN_INTEL_ADSP=y
CONFIG_SRAM_RETENTION_MODE=n

# Zephyr / logging
CONFIG_LOG_BACKEND_ADSP=n
CONFIG_WINSTREAM_CONSOLE=n
```

## app/boards/intel_adsp_cavs25_tgph.conf
```kconfig
CONFIG_TIGERLAKE=y
CONFIG_COMP_CHAIN_DMA=y
CONFIG_LP_MEMORY_BANKS=1
CONFIG_HP_MEMORY_BANKS=30
CONFIG_MM_DRV=y
CONFIG_INTEL_MODULES=y
CONFIG_LIBRARY_MANAGER=y
CONFIG_RIMAGE_SIGNING_SCHEMA="tgl-h"

CONFIG_DEBUG_COREDUMP=y
CONFIG_DEBUG_COREDUMP_BACKEND_INTEL_ADSP_MEM_WINDOW=y
CONFIG_DEBUG_COREDUMP_MEMORY_DUMP_MIN=y

# DTRACE is IPC3 only, disable it
CONFIG_TRACE=n

CONFIG_IPC_MAJOR_4=y
CONFIG_IPC4_BASE_FW_INTEL=y
CONFIG_RIMAGE_SIGNING_SCHEMA="tgl-cavs"
CONFIG_PCM_CONVERTER_FORMAT_S16LE=y
CONFIG_PCM_CONVERTER_FORMAT_S24LE=y
CONFIG_PCM_CONVERTER_FORMAT_S32LE=y
CONFIG_PCM_CONVERTER_FORMAT_S24_3LE=y
CONFIG_PCM_CONVERTER_FORMAT_FLOAT=y
CONFIG_PCM_CONVERTER_FORMAT_S16_C16_AND_S16_C32=y
CONFIG_PCM_CONVERTER_FORMAT_S16_C32_AND_S32_C32=y
CONFIG_PCM_CONVERTER_FORMAT_S16_C32_AND_S24_C32=y
CONFIG_PCM_CONVERTER_FORMAT_S16_C32_AND_S16_C32=y
CONFIG_COMP_VOLUME_WINDOWS_FADE=y
CONFIG_COMP_DRC=y
CONFIG_COMP_CROSSOVER=y
CONFIG_COMP_MULTIBAND_DRC=y
CONFIG_COMP_ARIA=y
CONFIG_COMP_MFCC=y

# route SOF logs to Zephyr logging subsystem
CONFIG_SOF_LOG_LEVEL_INF=y
CONFIG_ZEPHYR_LOG=y

# use mtrace for IPC4 and disable etrace/ADSP backend
CONFIG_LOG_BACKEND_ADSP_MTRACE=y
CONFIG_LOG_BACKEND_ADSP=n
CONFIG_LOG_OUTPUT_FORMAT_LINUX_TIMESTAMP=y
CONFIG_WINSTREAM_CONSOLE=n

CONFIG_LOG_FUNC_NAME_PREFIX_ERR=y
CONFIG_LOG_FUNC_NAME_PREFIX_WRN=y
CONFIG_LOG_FUNC_NAME_PREFIX_INF=y
CONFIG_LOG_FUNC_NAME_PREFIX_DBG=y

CONFIG_INTEL_ADSP_TIMER=y
CONFIG_FORMAT_CONVERT_HIFI3=n

CONFIG_PM=y
CONFIG_PM_DEVICE=y
CONFIG_PM_DEVICE_RUNTIME=y
CONFIG_PM_POLICY_CUSTOM=y

CONFIG_CLOCK_CONTROL_ADSP=y
CONFIG_CLOCK_CONTROL=y

CONFIG_ZEPHYR_NATIVE_DRIVERS=y
CONFIG_DAI=y
CONFIG_DAI_INIT_PRIORITY=70
CONFIG_DAI_INTEL_SSP=y
CONFIG_DAI_INTEL_DMIC=y
CONFIG_DAI_INTEL_ALH=y
CONFIG_DAI_INTEL_DMIC_NHLT=y
CONFIG_DAI_INTEL_HDA=y
CONFIG_DAI_DMIC_HW_IOCLK=38400000

CONFIG_INTEL_ADSP_IPC=y

CONFIG_DMA=y
CONFIG_DMA_DW_LLI_POOL_SIZE=100
CONFIG_DMA_DW_HW_LLI=y
CONFIG_DMA_DW_FIFO_PARTITION=y
CONFIG_DMA_INTEL_ADSP_GPDMA_HAS_LLP=y

CONFIG_HEAP_MEM_POOL_SIZE=8192
CONFIG_LOG_TIMESTAMP_64BIT=y
```

## app/boards/mimx93_evk_a55.conf
```kconfig
#
# Copyright 2023 NXP
#
# SPDX-License-Identifier: Apache-2.0

# Enable dynamic interrupts
CONFIG_DYNAMIC_INTERRUPTS=y

CONFIG_ARM64_VA_BITS_40=y
CONFIG_ARM64_PA_BITS_40=y

CONFIG_DCACHE_LINE_SIZE_DETECT=n
CONFIG_DCACHE_LINE_SIZE=64

CONFIG_IMX93_A55=y
CONFIG_TRACE=n
```

## app/boards/mt8188_mt8188_adsp.conf
```kconfig
# Boilerplate.  Because the "Platform" is a kconfig "choice" (of which
# "MTK" is an member), it can't be selected automatically from other
# kconfigs, nor expressed as a default.  Don't put anything else here.
# Board-level config goes in Zephyr (and ideally in DTS).  App-level
# config goes in prj.conf.
CONFIG_MTK=y

# Override project default setting so 1 millisecond is exactly
# represented by an integral number of ticks.
CONFIG_SYS_CLOCK_TICKS_PER_SEC=13000
```
