## src/samples/audio/Kconfig
```kconfig
# SPDX-License-Identifier: BSD-3-Clause

menu "Audio component samples"

        config SAMPLE_SMART_AMP
	        tristate "Smart amplifier test component"
		default m if METEORLAKE
	        default y
	        help
	                Select for test smart amplifier component

        config SAMPLE_KEYPHRASE
		depends on CAVS || IMX || ACE
	        bool "Keyphrase test component"
	        default y
	        help
	                Select for Keyphrase test component.
	                Provides basic functionality for use in testing of keyphrase detection pipelines.

	config KWD_NN_SAMPLE_KEYPHRASE
                depends on IMX
                bool "KWD NN Keyphrase test component"
                default n
                help
			Select for KWD NN Keyphrase test component based on neural network.
			Provides ML functionality for use in testing of keyphrase detection pipelines.
			Use KWD based on NN as alternative to the default KWD component.
			Provides neural network as a library.
endmenu
```

## src/schedule/Kconfig.threads_prio
```kconfig
# SPDX-License-Identifier: BSD-3-Clause

config LL_THREAD_PRIORITY
	int "LL thread cooperative high priority"
	default -16
	help
	  LL thread configured priority in the system.
	  Should be in cooperative range:
	  -NUM_COOP_PRIORITIES to -1

config TWB_THREAD_MEDIUM_PRIORITY
	int "TWB thread preemptible medium priority"
	default 1
	help
	  TWB thread configured priority in the system.
	  Should be in preemptible range:
	  0 to NUM_PREEMPT_PRIORITIES-1

config TWB_THREAD_LOW_PRIORITY
	int "TWB thread preemptible low priority"
	default 12
	help
	  TWB thread configured priority in the system.
	  Should be in preemptible range:
	  0 to NUM_PREEMPT_PRIORITIES-1

config DP_THREAD_PRIORITY
	int "DP thread preemptible low priority"
	default 12
	help
	  DP thread configured priority in the system.
	  Should be in preemptible range:
	  0 to NUM_PREEMPT_PRIORITIES-1

config EDF_THREAD_PRIORITY
	int "EDF thread preemptible low priority"
	default 1
	help
	  EDF thread configured priority in the system.
	  Should be in preemptible range:
	  0 to NUM_PREEMPT_PRIORITIES-1
```

## src/trace/Kconfig
```kconfig
# SPDX-License-Identifier: BSD-3-Clause

# Trace configs

menu "Trace"

config TRACE
	bool "Trace"
	default y
	help
	  Enabling traces. All traces (normal and error) are sent by dma.

config TRACEV
	bool "Trace verbose"
	depends on TRACE
	default n
	help
	  Enabling verbose traces. tr_dbg() statements depend on this at
	  compile-time and on run-time filtering below too.

config TRACEE
	bool "Trace error"
	depends on TRACE
	default y
	help
	  Sending error traces by mailbox additionally.

config TRACEM
	bool "Trace mailbox"
	depends on TRACE
	default n
	help
	  Sending all traces by mailbox additionally.

config TRACE_FILTERING
	bool "Trace filtering"
	depends on TRACE
	default y
	help
		Filtering of trace messages based on their verbosity level and/or frequency.

config TRACE_FILTERING_VERBOSITY
	bool "Filter by verbosity"
	depends on TRACE_FILTERING
	default y
	help
		Filtering by log verbosity level, where maximum verbosity allowed is specified for each
		context and may be adjusted in runtime. Most basic feature found in every logger.

config TRACE_FILTERING_ADAPTIVE
	bool "Adaptive rate limiting"
	depends on TRACE_FILTERING
	default y
	help
		Adaptive filtering of repeating trace messages, tracking up to
		CONFIG_TRACE_RECENT_ENTRIES_COUNT and suppressing messages repeated in less than
		CONFIG_TRACE_RECENT_TIME_THRESHOLD microseconds. This filtering and suppression are
		turned off as soon as the user makes any runtime configuration change using the
		sof-logger -F flag. Warning: log message parameters (formatted with a conversion
		specifier %_) are ignored when comparing repeated messages and they are dropped by
		this filtering.

config TRACE_RECENT_ENTRIES_COUNT
	int "How many recent log messages are stored"
	depends on TRACE_FILTERING_ADAPTIVE
	default 5
	help
		The most recent log messages are stored to match the currently processed
		message. The size of that window affects effectiveness and performance. More recent
		entries allow to better filter repetitive messages out, but also slightly decrease
		performance due to the increased number of comparisons necessary.

config TRACE_RECENT_TIME_THRESHOLD
	int "Period of time considered recent (microseconds)"
	depends on TRACE_FILTERING_ADAPTIVE
	default 1500
	range 1 TRACE_RECENT_MAX_TIME
	help
		Period of time during which entries are tracked and will be suppressed if reported again.
		Entries expire after this time.

config TRACE_RECENT_MAX_TIME
	int "Maximum period of time that message can be suppressed (microseconds)"
	depends on TRACE_FILTERING_ADAPTIVE
	default 5000000
	help
		Maximum amount of time message can be suppressed for, due to repeated suppression.

config TRACE_BURST_COUNT
	int "Allowed amount of rapidly repeated messages, that will not be suppressed by the filter"
	depends on TRACE_FILTERING_ADAPTIVE
	default 4
	help
		Amount of messages that will pass through the filter even if sent in rapid succession.
		Allowed message burst size before filter suppresses the message.

config LOG_BACKEND_SOF_PROBE
	bool "Logging backend with SOF probes"
	depends on LOG
	select LOG_OUTPUT
	help
		Enable backend for log output via SOF probe interface.
		Probe interface allows to transmit logs and PCM data, muxed over
		a shared DMA channel.
		Logging is enabled by setting up a probe point with
		probe purpose value of PROBE_PURPOSE_LOGGING.

config LOG_BACKEND_SOF_PROBE_OUTPUT_DICTIONARY
	bool "Dictionary"
	select LOG_DICTIONARY_SUPPORT
	help
		Set output format of the SOF probe logging backend to
		Zephyr log dictionary.
		The resulting log file can be parsed with tools in
		zephyr/scripts/logging/dictionary
		A dictionary for the binary is created during build.

config LOG_BACKEND_SOF_PROBE_OUTPUT
	int "Set logging output format"
	default 1 if LOG_MIPI_SYST_ENABLE
	default 2 if LOG_BACKEND_SOF_PROBE_OUTPUT_DICTIONARY
	default 0 # Text encoding is default
        help
                Set the logging format for SOF probe output.

endmenu
```

## test/cmocka/configs/acp_7_0_defconfig
```kconfig
CONFIG_ACP_7_0=y
CONFIG_RIMAGE_SIGNING_SCHEMA="acp_7_0"
CONFIG_TRACE_CHANNEL=7
CONFIG_WRAP_ACTUAL_POSITION=y
CONFIG_AMD_BT=n
CONFIG_AMD_SP=n
CONFIG_CORE_COUNT=1
CONFIG_LP_MEMORY_BANKS=20
CONFIG_HP_MEMORY_BANKS=10
CONFIG_FORMAT_CONVERT_HIFI3=n
CONFIG_LP_SRAM=n
CONFIG_HAVE_AGENT=n
CONFIG_COMP_VOLUME=n
CONFIG_COMP_SRC=n
CONFIG_COMP_FIR=n
CONFIG_COMP_IIR=n
CONFIG_COMP_DCBLOCK=n
CONFIG_COMP_CROSSOVER=n
CONFIG_COMP_DRC=n
CONFIG_COMP_MULTIBAND_DRC=n
CONFIG_COMP_TONE=n
CONFIG_COMP_SWITCH=n
CONFIG_COMP_KPB=n
CONFIG_MAXIM_DSM=n
CONFIG_COMP_ASRC=n
CONFIG_COMP_IGO_NR=n
CONFIG_COMP_COPIER=n
CONFIG_COMP_RTNR=n
CONFIG_COMP_ARIA=n
CONFIG_COMP_BASEFW_IPC4=n
CONFIG_COMP_UP_DOWN_MIXER=n
CONFIG_COMP_TDFB=n
CONFIG_COMP_MUX=n
CONFIG_COMP_SEL=n
CONFIG_COMP_MIXER=n
CONFIG_PROBE=n
```

## test/ztest/unit/batch/testcase.yaml
```yaml
# SPDX-License-Identifier: BSD-3-Clause
#
# Copyright(c) 2025 Intel Corporation.
#
# Batch allocator unit tests for Ztest framework

tests:
  sof.batch:
    tags: unit
    platform_allow: native_sim
    integration_platforms:
      - native_sim
    build_only: false
```

## test/ztest/unit/dsrc/testcase.yaml
```yaml
# SPDX-License-Identifier: BSD-3-Clause
#
# Copyright 2026 Intel Corporation. All rights reserved.

tests:
  sof.unit.dsrc:
    tags: dsrc
    platform_allow: native_sim
    integration_platforms:
      - native_sim
    build_only: false
```

## test/ztest/unit/fast-get/testcase.yaml
```yaml
# SPDX-License-Identifier: BSD-3-Clause
#
# Copyright(c) 2025 Intel Corporation. All rights reserved.
#
# These contents may have been developed with support from one or more Intel-operated
# generative artificial intelligence solutions.

tests:
  sof.unit.fast_get:
    tags: fast_get memory cache
    platform_allow: native_sim
    integration_platforms:
      - native_sim
    build_only: false
```

## test/ztest/unit/list/testcase.yaml
```yaml
# SPDX-License-Identifier: BSD-3-Clause
#
# Copyright(c) 2025 Intel Corporation. All rights reserved.
#
# These contents may have been developed with support from one or more Intel-operated
# generative artificial intelligence solutions.

tests:
  sof.list:
    platform_allow: native_sim
    harness: ztest
    tags: unit
```

## test/ztest/unit/math/advanced/functions/testcase.yaml
```yaml
# SPDX-License-Identifier: BSD-3-Clause
#
# Copyright(c) 2025 Intel Corporation. All rights reserved.
#
# Math advanced functions unit tests for Ztest framework
#
# These contents may have been developed with support from one or more Intel-operated
# generative artificial intelligence solutions.
#

tests:
  math.advanced.functions:
    tags: math advanced functions power
    platform_allow: native_sim
    integration_platforms:
      - native_sim
    build_only: false
```
