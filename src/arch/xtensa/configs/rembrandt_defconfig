## src/audio/asrc/Kconfig
```kconfig
# SPDX-License-Identifier: BSD-3-Clause

config COMP_ASRC
	tristate "ASRC component"
	default m if LIBRARY_DEFAULT_MODULAR
	default y
	help
	  Select for Asynchronous sample rate conversion (ASRC)
	  component. The ASRC has the capabilities of (synchronous)
	  SRC but can in addition track a slave DAI that is not in
	  sync with firmware timer. The ASRC can be setup for
	  synchronous operation without DAI tracking via topology
	  though it has a bit higher computational load than SRC. The
	  RAM footprint of ASRC is smaller than SRC because it does
	  not have pre-computed filter coefficients for every
	  conversion fraction that SRC does.

if COMP_ASRC != n

rsource "Kconfig.simd"

choice
        prompt "ASRC down sampling conversions set"
        default COMP_ASRC_DOWNSAMPLING_FULL

config COMP_ASRC_DOWNSAMPLING_FULL
	bool "Full downsampling conversions support"
	select ASRC_SUPPORT_CONVERSION_24000_TO_08000
	select ASRC_SUPPORT_CONVERSION_24000_TO_16000
	select ASRC_SUPPORT_CONVERSION_48000_TO_08000
	select ASRC_SUPPORT_CONVERSION_48000_TO_11025
	select ASRC_SUPPORT_CONVERSION_48000_TO_12000
	select ASRC_SUPPORT_CONVERSION_48000_TO_16000
	select ASRC_SUPPORT_CONVERSION_48000_TO_22050
	select ASRC_SUPPORT_CONVERSION_48000_TO_24000
	select ASRC_SUPPORT_CONVERSION_48000_TO_32000
	select ASRC_SUPPORT_CONVERSION_48000_TO_44100
	help
	  This option enables all supported downsampling conversions
	  for the asynchronous sample rate conversion. All the
	  upsampling conversions use the same filter always enabled
	  coefficients set so there is no configuration options for
	  them. The enabled conversions consume about 18 kB of memory.

config COMP_ASRC_DOWNSAMPLING_CUSTOM
	bool "Custom downsampling conversions support"
	help
	  This option used to manually select each downsampling ratio.
	  In order to optimize the text code size of the sample rate
	  converter, non-required conversion ratios can be
	  deactivated.  Disregarding these settings, the sample rate
	  converter always supports all conversion ratios with fs_in
	  less or equal to fs_out. Therefore, it is possible to
	  deactivate all conversion ratios listed below, if we only
	  need an (asynchronous) 1:1 sample rate conversion, e.g, from
	  16 kHz to 16 kHz. This option allows to trim down the coefficient
	  memory for conversion down from default 18 kB. Each conversion
	  needs about 2 kB.

endchoice

menu "Supported downsampling conversions"
	visible if COMP_ASRC_DOWNSAMPLING_CUSTOM

config ASRC_SUPPORT_CONVERSION_24000_TO_08000
	bool "Downsample 24 kHz to 8 kHz"
	help
	  This option enables downsampling from 24 kHz to 8 kHz into
	  the build. The consumption of memory is 2.1 kB.

config ASRC_SUPPORT_CONVERSION_24000_TO_16000
	bool "Downsample 24 kHz to 16 kHz"
	help
	  This option enables downsampling from 24 kHz to 16 kHz into
	  the build. The consumption of memory is 1.9 kB.

config ASRC_SUPPORT_CONVERSION_48000_TO_08000
	bool "Downsample 48 kHz to 8 kHz"
	help
	  This option enables downsampling from 48 kHz to 8 kHz into
	  the build. The consumption of memory is 2.1 kB.

config ASRC_SUPPORT_CONVERSION_48000_TO_11025
	bool "Downsample 48 kHz to 11.025 kHz"
	help
	  This option enables downsampling from 48 kHz to 11.025 kHz
	  into the build. The consumption of memory is 1.5 kB.

config ASRC_SUPPORT_CONVERSION_48000_TO_12000
	bool "Downsample 48 kHz to 12 kHz"
	help
	  This option enables downsampling from 48 kHz to 12 kHz into
	  the build. The consumption of memory is 1.5 kB.

config ASRC_SUPPORT_CONVERSION_48000_TO_16000
	bool "Downsample 48 kHz to 16 kHz"
	help
	  This option enables downsampling from 48 kHz to 16 kHz into
	  the build. The consumption of memory is 1.9 kB.

config ASRC_SUPPORT_CONVERSION_48000_TO_22050
	bool "Downsample 48 kHz to 22.05 kHz"
	help
	  This option enables downsampling from 48 kHz to 22.05 kHz into
	  the build. The consumption of memory is 1.6 kB.

config ASRC_SUPPORT_CONVERSION_48000_TO_24000
	bool "Downsample 48 kHz to 24 kHz"
	help
	  This option enables downsampling from 48 kHz to 24 kHz into
	  the build. The consumption of memory is 1.6 kB.

config ASRC_SUPPORT_CONVERSION_48000_TO_32000
	bool "Downsample 48 kHz to 32 kHz"
	help
	  This option enables downsampling from 48 kHz to 32 kHz into
	  the build. The consumption of memory is 1.9 kB.

config ASRC_SUPPORT_CONVERSION_48000_TO_44100
	bool "Downsample 48 kHz to 44.1 kHz"
	help
	  This option enables downsampling from 48 kHz to 44.1 kHz
	  into the build. The consumption of memory is 1.8 kB.

endmenu # "Downsampling ratios"

endif # COMP_ASRC
```

## src/audio/asrc/Kconfig.simd
```kconfig
# SPDX-License-Identifier: BSD-3-Clause

comment "ASRC optimization level select"

choice "ASRC_SIMD_LEVEL_SELECT"
	prompt "choose which SIMD level used for ASRC module"
	depends on COMP_ASRC
	default ASRC_HIFI_MAX

	config ASRC_HIFI_MAX
		prompt "SIMD will selected by toolchain pre-defined header"
		bool
		help
			When this was selected, optimization level will be determined
			by toolchain pre-defined macros in core isa header file.

	config ASRC_HIFI_5
		prompt "choose HIFI5 intrinsic optimized ASRC module"
		bool
		help
			This option used to build HIFI5 optimized ASRC code

	config ASRC_HIFI_4
		prompt "choose HIFI4 intrinsic optimized ASRC module"
		bool
		help
			This option used to build HIFI4 optimized ASRC code

	config ASRC_HIFI_3
		prompt "choose HIFI3 intrinsic optimized ASRC module"
		bool
		help
			This option used to build HIFI3 intrinsic optimized ASRC code

	config ASRC_HIFI_NONE
		prompt "choose generic C ASRC module, no HIFI SIMD involved"
		bool
		help
			This option used to build ASRC generic code.
endchoice
```

## src/audio/codec/Kconfig
```kconfig
# SPDX-License-Identifier: BSD-3-Clause

config DTS_CODEC
        tristate "DTS codec"
        select DTS_CODEC_STUB if COMP_STUBS
        help
          Select to include DTS codec.
          In order to compile with this option enabled, a pre-compiled static library
          must be provided by DTS for your target platform. If this library is not present
          then compilation errors will occur.
          For more information, please contact sales@xperi.com

config DTS_CODEC_STUB
        bool "DTS codec stub"
        depends on DTS_CODEC
        help
          Select to include DTS codec stub library. This is meant for testing and CI
          purposes only.
```

## src/audio/codec_adapter/Kconfig
```kconfig
# SPDX-License-Identifier: BSD-3-Clause

menu "Codec Adapter codecs"
	visible if COMP_CODEC_ADAPTER

	config CADENCE_CODEC
		bool "Cadence codec"
		default n
		help
		  Select for codecs which conforms to the Cadence API.
		  This will cause codec adapter component to include header
		  files specific to CADENCE base codecs.

if CADENCE_CODEC
	config CADENCE_CODEC_WRAPPER
		bool 'Cadence codec wrapper'
		default n
		help
		  Select for cadence_codec_api wrapper function that will allow
		  users to call into codecs which conforms to the Cadence API without
		  explicitly knowing/using the entry function symbol name.

	if CADENCE_CODEC_WRAPPER
		config CADENCE_CODEC_WRAPPER_LIB
		string "Cadence codec wrapper library name"
		help
		  This option is a string and takes the full name of the codec wrapper library binary.
	endif

	config CADENCE_CODEC_AAC_DEC
		bool "Cadence AAC decoder"
		default n
		help
		  Select for Cadence AAC decoder support.
		  This will cause Cadence codec to include Cadence AAC library
		  api symbol.

	if CADENCE_CODEC_AAC_DEC
		config CADENCE_CODEC_AAC_DEC_LIB
		string "Cadence AAC decoder library name"
		help
		  This option is a string and takes the full name of the AAC decoder library binary.
	endif

	config CADENCE_CODEC_BSAC_DEC
		bool "Cadence BSAC decoder"
		default n
		help
		  Select for Cadence BSAC decoder support.
		  This will cause Cadence codec to include Cadence BSAC library
		  api symbol.

	if CADENCE_CODEC_BSAC_DEC
		config CADENCE_CODEC_BSAC_DEC_LIB
		string "Cadence BSAC decoder library name"
		help
		  This option is a string and takes the full name of the BSAC decoder library
	endif

	config CADENCE_CODEC_DAB_DEC
		bool "Cadence DAB decoder"
		default n
		help
		  Select for Cadence DAB decoder support.
		  This will cause Cadence codec to include Cadence DAB library
		  api symbol.

	if CADENCE_CODEC_DAB_DEC
		config CADENCE_CODEC_DAB_DEC_LIB
		string "Cadence DAB decoder library name"
		help
		  This option is a string and takes the full name of the DAB library binary.
	endif

	config CADENCE_CODEC_DRM_DEC
		bool "Cadence DRM decoder"
		default n
		help
		  Select for Cadence DRM decoder support.
		  This will cause Cadence codec to include Cadence DRM library
		  api symbol.

	if CADENCE_CODEC_DRM_DEC
		config CADENCE_CODEC_DRM_DEC_LIB
		string "Cadence DRM decoder library name"
		help
		  This option is a string and takes the full name of the DRM library binary.
	endif

	config CADENCE_CODEC_MP3_DEC
		bool "Cadence MP3 decoder"
		default n
		help
		  Select for Cadence MP3 decoder support.
		  This will cause Cadence codec to include Cadence MP3 library
		  api symbol.

	if CADENCE_CODEC_MP3_DEC
		config CADENCE_CODEC_MP3_DEC_LIB
		string "Cadence MP3 decoder library name"
		help
		  This option is a string and takes the full name of the MP3 library binary.
	endif

	config CADENCE_CODEC_SBC_DEC
		bool "Cadence SBC decoder"
		default n
		help
		  Select for Cadence SBC decoder support.
		  This will cause Cadence codec to include Cadence SBC library
		  api symbol.

	if CADENCE_CODEC_SBC_DEC
		config CADENCE_CODEC_SBC_DEC_LIB
		string "Cadence SBC decoder library name"
		help
		  This option is a string and takes the full name of the SBC library binary.
	endif

endif

	config PASSTHROUGH_CODEC
		bool "Passthrough codec"
		default n
		help
		  Select for a passthrough API codec implementation.
		  This will cause codec adapter component to include header
		  files specific to PASSTHROUGH base codecs.

	config WAVES_CODEC
	bool "Waves codec"
	default n
	help
		Select to include Waves codec. Waves codec implements MaxxEffect API.
		API definition together with pre-compiled library is shared by Waves Audio Ltd.
		If library is not provided will result in compilation error.
		For more information, contact consumer@waves.com.
endmenu
```

## src/audio/copier/Kconfig
```kconfig
# SPDX-License-Identifier: BSD-3-Clause

rsource "Kconfig.simd"

config COMP_COPIER
        bool "COPIER component"
        default y
        depends on IPC_MAJOR_4
        help
          Select for COPIER component

config COMP_DAI
	bool "DAI component"
	default y
	help
	  Select for DAI component

config COMP_DAI_STOP_TRIGGER_ORDER_REVERSE
	bool "Reverse the ordering of DMA and DAI triggers during STOP/PAUSE"
	help
	  Select if the ordering of DMA and DAI triggers during stop/pause should be reversed.
	  The normal order during stop/pause is to stop DAI before stopping DMA. This option will
	  allow reversing the order to do DMA stop before stopping DAI.

config COMP_DAI_GROUP
	bool "DAI Grouping support"
	default y
	help
	  Select for grouping physical DAIs into a logical DAI that can be
	  triggered atomically to synchronise stream start and stop operations.

if COMP_COPIER

config COPIER_GAIN
	bool "COPIER gain feature"
	default y
	  help
	    Select for using copier gain feature. There are three modes available:
	    - Static gain: gain is set at initialization and remains constant.
	    - Mute: gain is set to 0, signal is muted.
	    - Transition gain: gain is set to a target value over a specified time.
	      Common use cases are fade-in and fade-out effects.
endif
```

## src/audio/copier/Kconfig.simd
```kconfig
# SPDX-License-Identifier: BSD-3-Clause

comment "COPIER optimization level select"

choice "COPIER_SIMD_LEVEL_SELECT"
	prompt "choose which SIMD level used for COPIER module"
	depends on COMP_COPIER
	default COPIER_HIFI_MAX

	config COPIER_HIFI_MAX
		prompt "SIMD will selected by toolchain pre-defined header"
		bool
		help
			When this was selected, optimization level will be determined
			by toolchain pre-defined macros in core isa header file.

	config COPIER_HIFI_5
		prompt "choose HIFI5 intrinsic optimized COPIER module"
		bool
		help
			This option used to build HIFI5 optimized COPIER code

	config COPIER_HIFI_4
		prompt "choose HIFI4 intrinsic optimized COPIER module"
		bool
		help
			This option used to build HIFI4 optimized COPIER code

	config COPIER_HIFI_3
		prompt "choose HIFI3 intrinsic optimized COPIER module"
		bool
		help
			This option used to build HIFI3 intrinsic optimized COPIER code

	config COPIER_HIFI_NONE
		prompt "choose generic C COPIER module, no HIFI SIMD involved"
		bool
		help
			This option used to build COPIER generic code.
endchoice
```

## src/audio/crossover/Kconfig
```kconfig
# SPDX-License-Identifier: BSD-3-Clause

config COMP_CROSSOVER
	tristate "Crossover Filter component"
	select COMP_BLOB
	select MATH_IIR_DF2T
	default m if LIBRARY_DEFAULT_MODULAR
	help
	  Select for Crossover Filter component. A crossover can be used to
	  split a signal into two or more frequency ranges, so that the outputs
	  can be sent to drivers that are designed for those ranges.
```

## src/audio/drc/Kconfig
```kconfig
# SPDX-License-Identifier: BSD-3-Clause

rsource "Kconfig.simd"

config COMP_DRC
	tristate "Dynamic Range Compressor component"
	select CORDIC_FIXED
        select MATH_LUT_SINE_FIXED
	select NUMBERS_NORM
	select MATH_EXP
	select COMP_BLOB
	default m if LIBRARY_DEFAULT_MODULAR
	default n
	help
	  Select for Dynamic Range Compressor (DRC) component. A DRC can be used
	  to reduce the volume of loud sounds and amplify silent sounds thus
	  compressing an audio signal's dynamic range.

config DRC_MAX_PRE_DELAY_FRAMES
	depends on COMP_DRC
	int "DRC max number of pre-delay frames"
	default 512
	help
	  Determines the length of pre-delay frame buffers which are allocated
	  runtime on DRC setup. It requires to be a 2^N number. 512 is
	  suggested by inference to avoid memory waste and provide reasonable
	  length for pre-delay frames.
```

## src/audio/drc/Kconfig.simd
```kconfig
# SPDX-License-Identifier: BSD-3-Clause

comment "DRC optimization level select"

choice "DRC_SIMD_LEVEL_SELECT"
	prompt "choose which SIMD level used for DRC module"
	depends on COMP_DRC
	default DRC_HIFI_MAX

	config DRC_HIFI_MAX
		prompt "SIMD will selected by toolchain pre-defined header"
		bool
		help
			When this was selected, optimization level will be determined
			by toolchain pre-defined macros in core isa header file.

	config DRC_HIFI_5
		prompt "choose HIFI5 intrinsic optimized DRC module"
		bool
		help
			This option used to build HIFI5 optimized DRC code

	config DRC_HIFI_4
		prompt "choose HIFI4 intrinsic optimized DRC module"
		bool
		help
			This option used to build HIFI4 optimized DRC code

	config DRC_HIFI_3
		prompt "choose HIFI3 intrinsic optimized DRC module"
		bool
		help
			This option used to build HIFI3 intrinsic optimized DRC code

	config DRC_HIFI_NONE
		prompt "choose generic C DRC module, no HIFI SIMD involved"
		bool
		help
			This option used to build DRC generic code.
endchoice
```

## src/audio/eq_fir/Kconfig
```kconfig
# SPDX-License-Identifier: BSD-3-Clause

config COMP_FIR
	tristate "FIR component"
	select MATH_FIR
	select COMP_BLOB
	depends on COMP_MODULE_ADAPTER
	default m if LIBRARY_DEFAULT_MODULAR
	default y
	help
	  Select for FIR component. FIR performance can differ between DSP
	  ISA and compiler used. FIR will perform best when MAC instructions
	  are available in ISA and are used by the compiler. i.e. xt-xcc on
	  xtensa will generate MAC instructions but GCC on xtensa won't.
	  Filter tap count can be severely restricted to reduce FIR cycles
	  and FIR performance for DSP/compilers with no MAC support
```
