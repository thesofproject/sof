## src/audio/tensorflow/Kconfig
```kconfig
# SPDX-License-Identifier: BSD-3-Clause

config COMP_TENSORFLOW
	tristate "Tensorflow Micro component"
	depends on SOF_STAGING
	depends on CPP
	depends on STD_CPP17
	help
	  Select for Tensorflow component support. This module supports
	  Tensorflow Micro library. It is used for running machine learning
	  models on DSP. It is a lightweight version of Tensorflow library
	  designed for microcontrollers and embedded systems.

if COMP_TENSORFLOW

config COMP_TENSORFLOW_DEBUG_TRACE
	bool "Verbose per-hop / per-inference debug traces"
	default n
	help
	  Enable the tflmcly per-hop ("[DBG hop N]"), per-inference
	  ("[PERF] TFLM Inference #N", "[DBG raw_output]", "TFLM top
	  prediction", per-node cycle counters, model-graph node count)
	  and sliding-window ("[DBG window] nonsat=…") debug prints in
	  the tflm-classify hot path. These fire ~50 times per second
	  (once per 20 ms MFCC hop) plus a burst every 500 ms and go
	  through printk/mtrace, which is not free on the DSP and can
	  contribute to backpressure on log/RTT paths.

	  Leave disabled for production and normal capture tuning. Enable
	  only when actively debugging feature extraction, quantization,
	  or per-node timing. The keyword-detected line and the shutdown
	  summary remain enabled regardless of this option.

endif # COMP_TENSORFLOW
```

## src/audio/vad_gate/Kconfig
```kconfig
# SPDX-License-Identifier: BSD-3-Clause

config COMP_VAD_GATE
	bool "VAD gate component"
	depends on IPC_MAJOR_4
	help
	  Select to build the VAD (Voice Activity Detection) gate component.
	  The gate sits between the DMIC copier and the downstream Mixin in
	  a WOV capture pipeline.  During silence it drains the DMIC input
	  and returns PPL_STATUS_PATH_STOP so KPB and WOV detectors idle.
	  When voice onset is detected audio flows through and the downstream
	  chain wakes and begins buffering.

if COMP_VAD_GATE

config VAD_GATE_DEFAULT_THRESHOLD
	int "VAD gate default energy threshold"
	default 0
	help
	  Default peak energy threshold below which frames are treated as silence.
	  0 = bypass (pass-through) — all audio reaches downstream; useful for lab
	  testing where stimulus is a hand clap.  Set to a non-zero value to enable
	  energy-based gating.

config VAD_GATE_DEFAULT_ONSET_FRAMES
	int "VAD gate default onset frame count"
	default 3
	help
	  Number of consecutive above-threshold frames required before the gate
	  opens (SPEECH onset).

config VAD_GATE_DEFAULT_HANGOVER_FRAMES
	int "VAD gate default hangover frame count"
	default 200
	help
	  Number of consecutive below-threshold frames required before the gate
	  closes (SILENCE).

endif # COMP_VAD_GATE
```

## src/audio/webrtc_agc/Kconfig
```kconfig
# SPDX-License-Identifier: BSD-3-Clause

config COMP_WEBRTC_AGC
	tristate "WebRTC Automatic Gain Control (AGC) module"
	default n
	help
	  Select to enable the WebRTC Automatic Gain Control (digital_agc) module.
	  Normalizes speech levels and provides brickwall peak limiting.

if COMP_WEBRTC_AGC

config COMP_WEBRTC_AGC_STUB
	bool "Build with pass-through stub backend"
	default n
	help
	  Select to build with the pass-through stub backend instead of the real AGC.

config WEBRTC_AGC_TARGET_DBFS
	int "Target level in dBFS below full scale"
	default 3
	range 0 31
	help
	  Target envelope level in -dBFS (default 3 means -3 dBFS).

config WEBRTC_AGC_COMPRESSION_GAIN_DB
	int "Compression gain in dB"
	default 9
	range 0 90
	help
	  Maximum compression gain in dB (default 9 dB).

config WEBRTC_AGC_LIMITER
	bool "Enable digital saturation limiter"
	default y
	help
	  Enables peak limiter to prevent saturation and clipping.

endif # COMP_WEBRTC_AGC
```

## src/audio/webrtc_hpf/Kconfig
```kconfig
# SPDX-License-Identifier: BSD-3-Clause

config COMP_WEBRTC_HPF
	tristate "WebRTC High-Pass Filter (HPF) module"
	default n
	help
	  Select to enable the WebRTC High-Pass Filter module.
	  Removes DC offset and low-frequency rumble (<80 Hz) using a 2nd-order cascaded biquad IIR.

if COMP_WEBRTC_HPF

config COMP_WEBRTC_HPF_STUB
	bool "Build with pass-through stub backend"
	default n
	help
	  Select to build with the pass-through stub backend instead of the real filter.

endif # COMP_WEBRTC_HPF
```

## src/audio/webrtc_ns/Kconfig
```kconfig
# SPDX-License-Identifier: BSD-3-Clause

config COMP_WEBRTC_NS
	tristate "WebRTC Noise Suppression (classic spectral Wiener filter)"
	help
	  Select to include the WebRTC Noise Suppression module. It wraps
	  the classic WebRTC NS algorithm — a frequency-domain spectral
	  subtraction / Wiener filter — as a single-input, single-output
	  PCM effect module.

	  The NS module reduces stationary and slowly-varying background
	  noise (HVAC hum, fan noise, electrical hiss). It is independent
	  of the ffmpeg afftdn filter already available through ffmpeg_dec,
	  providing users a build-time choice between the two.

	  The real backend uses the pure-C noise_suppression module
	  extracted from webrtc-audio-processing 0.3.x (no abseil, no C++,
	  BSD-3-Clause). Source is fetched via west (west update).

	  Without the source, or for CI/testing, select COMP_WEBRTC_NS_STUB.

if COMP_WEBRTC_NS

config COMP_WEBRTC_NS_STUB
	bool "WebRTC NS stub backend (no WebRTC source dependency)"
	default y if COMP_STUBS
	help
	  Build the webrtc_ns module against a dependency-free stub backend
	  that passes audio through unmodified. Useful for CI validation of
	  the SOF module glue, LLEXT packaging, and topology wiring without
	  needing the cross-built libwebrtc_ns archive.

config WEBRTC_NS_LEVEL
	int "Noise suppression level (0=mild, 1=moderate, 2=aggressive, 3=very_aggressive)"
	range 0 3
	default 1
	help
	  Controls the aggressiveness of the noise suppressor:
	    0 - Mild (minimal suppression, lowest distortion)
	    1 - Moderate (recommended for most use cases)
	    2 - Aggressive
	    3 - Very aggressive (maximum suppression, most distortion)

config WEBRTC_NS_SAMPLE_RATE_HZ
	int "NS processing sample rate in Hz"
	default 16000
	help
	  The internal processing sample rate. The WebRTC NS algorithm works
	  best at 16000 Hz. When the pipeline runs at 48000 Hz the module
	  can downsample to 16 kHz for NS processing and upsample back to
	  48 kHz, saving significant CPU. Set to 48000 to process at full
	  rate (higher quality, higher CPU cost).
	  Valid values: 8000, 16000, 32000, 48000.

endif # COMP_WEBRTC_NS
```

## src/audio/webrtc_ns2/Kconfig
```kconfig
# SPDX-License-Identifier: BSD-3-Clause

config COMP_WEBRTC_NS2
	tristate "RNNoise deep-learning noise suppressor (floating-point)"
	help
	  Select to include the RNNoise module — a recurrent neural network
	  noise suppressor originally developed by Jean-Marc Valin (Mozilla /
	  Opus). RNNoise operates at 48 kHz on 10 ms (480-sample) mono frames
	  and achieves significantly better suppression of non-stationary noise
	  (music, babble, keyboard) than the classic spectral Wiener filter
	  (COMP_WEBRTC_NS).

	  The module is single-input, single-output and internally emits a
	  per-frame VAD probability (0.0–1.0) via NOTIFIER_ID_VAD, making it
	  a combined denoiser and activity detector.

	  Requirements:
	    - Floating-point unit (FPU=y on ACE30/PTL; soft-float also works
	      but at significant CPU cost)
	    - ~30 KB of state per channel (DenoiseState + RNN weights)
	    - Pipeline sample rate exactly 48000 Hz
	    - Pipeline period must be a multiple of 480 samples (10 ms)

	  The real backend builds RNNoise from source (west module rnnoise,
	  pinned at commit 70f1d256). For CI/stub builds select
	  COMP_WEBRTC_NS2_STUB.

	  License: BSD-3-Clause (xiph/rnnoise).

if COMP_WEBRTC_NS2

config COMP_WEBRTC_NS2_STUB
	bool "RNNoise stub backend (no RNNoise source dependency)"
	default y if COMP_STUBS
	help
	  Build webrtc_ns2 against a dependency-free pass-through stub instead
	  of the real RNNoise library. The stub passes audio through unmodified
	  and always reports VAD probability = 1.0. Used for CI and LLEXT
	  packaging validation without the RNNoise source.

config WEBRTC_NS2_CHANNELS_MAX
	int "Maximum channel count (each channel gets its own RNNoise instance)"
	range 1 8
	default 2
	help
	  RNNoise is strictly mono; the module runs one DenoiseState per
	  channel. Increasing this raises SRAM usage by ~30 KB per extra
	  channel. Set to 1 for pure mono capture pipelines.

config WEBRTC_NS2_VAD_NOTIFY
	bool "Emit NOTIFIER_ID_VAD event from RNNoise VAD probability"
	default y
	help
	  RNNoise returns a per-frame speech probability in [0.0, 1.0]. When
	  this option is enabled the module broadcasts a NOTIFIER_ID_VAD event
	  (speech=1 / silence=0) using a configurable threshold, providing a
	  combined denoiser + VAD without running a separate webrtc_vad module.

config WEBRTC_NS2_VAD_THRESHOLD_PCT
	int "VAD threshold as percentage of max probability (0-100)"
	range 0 100
	default 50
	depends on WEBRTC_NS2_VAD_NOTIFY
	help
	  Speech is declared when rnnoise_process_frame() returns a probability
	  >= this value / 100.0. 50 is a good default; lower values increase
	  sensitivity (more false positives), higher values reduce it.

endif # COMP_WEBRTC_NS2
```

## src/audio/webrtc_vad/Kconfig
```kconfig
# SPDX-License-Identifier: BSD-3-Clause

config COMP_WEBRTC_VAD
	tristate "WebRTC Voice Activity Detection (libfvad)"
	help
	  Select to include the WebRTC Voice Activity Detection module. It
	  wraps the libfvad library (a standalone pure-C extraction of the
	  WebRTC GMM VAD) behind the SOF module interface. The module
	  inspects each 10/20/30 ms PCM frame and annotates it as speech or
	  non-speech via a NOTIFIER_ID_VAD notifier event, leaving the audio
	  stream unmodified (pass-through).

	  libfvad supports 8, 16, 32 and 48 kHz; it resamples to 8 kHz
	  internally. The GMM classifier operates in Q15 fixed-point and
	  requires no FPU.

	  The real backend requires libfvad cross-built for the target
	  (west module: modules/audio/libfvad). Without the source, or for
	  CI/stub builds, select COMP_WEBRTC_VAD_STUB.

if COMP_WEBRTC_VAD

config COMP_WEBRTC_VAD_STUB
	bool "WebRTC VAD stub backend (no libfvad dependency)"
	default y if COMP_STUBS
	help
	  Build the webrtc_vad module against a dependency-free stub backend
	  instead of libfvad. The stub always reports speech (VAD = 1) so
	  the audio data flow and LLEXT packaging can be validated without
	  the libfvad source or a cross-built archive.

config WEBRTC_VAD_MODE
	int "VAD aggressiveness mode (0=quality ... 3=aggressive)"
	range 0 3
	default 2
	help
	  Sets the libfvad operating mode which controls the trade-off
	  between false-positive rate and missed-speech rate:
	    0 - highest quality (fewest false alarms, may miss quiet speech)
	    1 - moderate quality
	    2 - moderate aggressiveness (default)
	    3 - most aggressive (detects most speech, more false alarms)
	  This option is also used by the stub backend (mode value is ignored
	  by the stub but must be a valid integer for compilation).

config WEBRTC_VAD_FRAME_MS
	int "VAD frame length in milliseconds (10, 20 or 30)"
	default 10
	help
	  libfvad processes audio in fixed-size frames. Valid values are
	  10, 20 and 30 ms. Smaller frames give lower latency; 10 ms is
	  the recommended default and matches the WebRTC pipeline convention.
	  The SOF pipeline period must be a multiple of this value (the
	  module accumulates sub-frames internally if needed).

endif # COMP_WEBRTC_VAD
```

## src/debug/telemetry/Kconfig
```kconfig
# SPDX-License-Identifier: BSD-3-Clause

config SOF_TELEMETRY
	bool "enable telemetry"
	default n
	depends on !SOF_USERSPACE_LL
	help
	  Enables telemetry. Enables performance measurements and debug utilities
	  that use memory window 2 (debug window) as interface. Measurements include
	  systick_info measurement which measures scheduler task performance and may
	  slightly affect overall performance.

config SOF_TELEMETRY_PERFORMANCE_MEASUREMENTS
	bool "enable performance measurements"
	default n
	help
	  Enables performance measurements. Requires ADSP_MW interface. Each created component
	  can have its performance checked by measuring execution time of copy function.
	  Performance records are stored in the limited number of slots in Memory Window 3,
	  so only a certain number (PERFORMANCE_DATA_ENTRIES_COUNT) of components can be measured.

config SOF_TELEMETRY_IO_PERFORMANCE_MEASUREMENTS
	bool "enable I/O performance measurements"
	help
	  Enables IO performance measurements. Each data interface will have its data throughput
	  measured (IPC/IDC and GPIO will measure number of messages/state changes).
	  Disabled by default and enabled with IPC. Measurements can be extracted also by IPC.
	  Interfaces measured: IPC, IDC, DMIC, I2S, SNDW, HDA, USB, GPIO, I2c, I3C, UART, SPI, CSI_2, DTF.

if SOF_TELEMETRY

config SOF_TELEMETRY_EXTENDED_WINDOW
	bool "Extended telemetry directory in Memory Window 2 Slot 1"
	default y
	help
	  Places a 64-byte-aligned self-describing TEL2 directory header and
	  cache-line-concentrated hot counter zone after system_tick_info in
	  the telemetry debug window slot to expose internal SOF resources.

config SOF_TELEMETRY_HOT_CACHE_STAGING
	bool "Stage LL hot-path telemetry updates in L1 D-cache lines"
	depends on SOF_TELEMETRY_EXTENDED_WINDOW
	default y
	help
	  Accumulates LL hot-path counter increments in 64-byte-aligned L1 D$
	  lines and flushes dirty cache lines to the uncached memory window
	  once at the end of the LL tick.

config SOF_TELEMETRY_MEMORY
	bool "Memory, k_heap, virtual heap, and SRAM page telemetry"
	depends on SOF_TELEMETRY_EXTENDED_WINDOW
	select SYS_HEAP_RUNTIME_STATS
	default y
	help
	  Exports live usage, free bytes, high-water marks, and allocation
	  failure counters for sof_heap, shared_buffer_heap, ll_user_heap,
	  l3_heap, virtual_buffers_heap (vmh), and fast_get in MW2 Slot 1.

config SOF_TELEMETRY_VREGION
	bool "Virtual page (vpage) and virtual region (vregion) telemetry"
	depends on SOF_TELEMETRY_EXTENDED_WINDOW && SOF_VREGIONS
	default y
	help
	  Tracks vpage_ctx page usage/fragmentation and per-vregion lifetime
	  linear allocator and interim k_heap usage in MW2 Slot 1.

config SOF_TELEMETRY_PIPELINES
	bool "Pipeline and LL/DP scheduler telemetry"
	depends on SOF_TELEMETRY_EXTENDED_WINDOW
	default y
	help
	  Exports active pipeline states, periods, priorities, XRUN counts,
	  and per-core LL/DP task counts and deadline misses in MW2 Slot 1.

config SOF_TELEMETRY_DAIS
	bool "DAI and Host DMA gateway telemetry"
	depends on SOF_TELEMETRY_EXTENDED_WINDOW
	default y
	help
	  Exports active DAI and Host DMA gateway state, DMA channel, buffer
	  fill levels, XRUN/skip counts, and total bytes processed in MW2 Slot 1.

config SOF_TELEMETRY_THREADS
	bool "Compact Zephyr thread CPU and stack telemetry in MW2 Slot 1"
	depends on SOF_TELEMETRY_EXTENDED_WINDOW
	select THREAD_MONITOR
	select THREAD_NAME
	select THREAD_STACK_INFO
	select INIT_STACKS
	select THREAD_RUNTIME_STATS
	default y
	help
	  Periodically snapshots per-thread CPU load (%) and stack high-water
	  mark (%) into MW2 Slot 1 without requiring an extra 4 KB debug_stream slot.

config SOF_TELEMETRY_MODULE_RESOURCES
	bool "Per-module heap usage, CPC violation, and I/O telemetry in MW3"
	depends on SOF_TELEMETRY_PERFORMANCE_MEASUREMENTS
	default y
	help
	  Partitions Memory Window 3 to include per-component module_resources
	  (heap_usage, heap_high_water_mark), peak CPC vs budget, and relocating
	  io_perf_data_items from .bss into MW3.

config SOF_TELEMETRY_MAX_COMP_ENTRIES
	int "Maximum component entries in Memory Window 3"
	depends on SOF_TELEMETRY_PERFORMANCE_MEASUREMENTS
	range 1 88 if SOF_TELEMETRY_MODULE_RESOURCES
	range 1 170
	default 88 if SOF_TELEMETRY_MODULE_RESOURCES
	default 170
	help
	  Maximum number of component performance entries in Memory Window 3.

endif # SOF_TELEMETRY
```
