## src/schedule/Kconfig
```kconfig
# SPDX-License-Identifier: BSD-3-Clause

config SCHEDULE_DMA_SINGLE_CHANNEL
	bool
	default n
	help
	  Enable single-channel DMA scheduler

config SCHEDULE_DMA_MULTI_CHANNEL
	bool
	default n
	help
	  Enable multi-channel DMA scheduler

config SCHEDULE_LL_STATS_LOG
	bool "Log low-latency scheduler statistics"
	default y
	depends on !SOF_USERSPACE_LL
	help
	  Log statistics from low-latency scheduler. This is a low overhead
	  mechanism to gather average and worst-case execution times of
	  the low-latency scheduler invocations. A report is printed to
	  logging subsystem (rate defined via SCHEDULE_LL_STATS_LOG_WINDOW_SIZE).

config SCHEDULE_LL_STATS_LOG_EVERY_OTHER_WINDOW
	bool "Log only every other low-latency report"
	default y
	depends on SCHEDULE_LL_STATS_LOG
	help
	  Output statistics for every other statistics gathering window.
	  This is useful to filter out impact of the reporting itself. With many
	  logging implementations, the first iteration has a spike in
	  execution caused by logging out results for the previous statistics
	  window. By skipping every other window, the reporting overhead
	  can be excluded.

config SCHEDULE_LL_STATS_LOG_WINDOW_SIZE
	int "Low latency statistics window size"
	default 10
	depends on SCHEDULE_LL_STATS_LOG
	help
	  Size of the statistics window as a power of two. The window size
	  setting also impacts the rate of reporting. With 1ms scheduler tick,
	  default of 10 results in 1024msec window size.

config SCHEDULE_LL_NO_RESCHEDULE_TASK
	bool "Low-latency scheduler skips task rescheduling"
	default n
	help
	  Select this to instantiate the low-latency scheduler without task
	  rescheduling, given that the operation is optional. Under such cases,
	  scheduler_ops::reschedule_task will set to NULL instead, tasks with
	  the attempt to reschedule (e.g. DMA trace works) will be relinguished
	  directly and return no error.

config ZEPHYR_TWB_SCHEDULER
	bool "use Zephyr thread based TWB scheduler"
	default n
	depends on ZEPHYR_SOF_MODULE
	depends on TIMESLICE_PER_THREAD
	depends on THREAD_RUNTIME_STATS
	depends on SCHED_THREAD_USAGE
	help
	  Enable Tasks with Budget preemptive scheduler based on
	  Zephyr preemptive threads for each SOF task that has pre-allocated
	  MCPS budget renewed with every system tick.

config TWB_IPC_TASK
	bool "use TWB scheduler for IPC task"
	default n
	depends on ZEPHYR_TWB_SCHEDULER
	help
	  Switch IPC task to TWB scheduler.

config PIPELINE_2_0
	bool "Enable pipeline 2.0 changes"
	depends on IPC_MAJOR_4
	default y if ACE || LIBRARY
	help
	  This flag enables changes to new pipeline structure, known as pipeline2_0
	  It is required for certain new features, like DP_SCHEDULER.

config ZEPHYR_DP_SCHEDULER
	bool "use thread based DP scheduler"
	default y if ACE || LIBRARY
	depends on IPC_MAJOR_4
	depends on (ZEPHYR_SOF_MODULE && ACE) || LIBRARY
	depends on PIPELINE_2_0
	imply XTENSA_HIFI_SHARING if XTENSA_HIFI
	help
	  Enable Data Processing preemptive scheduler based on
	  preemptive threads (Zephyr threads on firmware targets, pthreads on host).
	  DP modules can be located in different cores than LL pipeline modules, may have
	  different tick (i.e. 300ms for speech recognition, etc.)

config ZEPHYR_DP_SCHEDULER_MIN_STACK_SIZE
	int "Minimum stack size for DP processing thread"
	default 512
	help
	  Defines the minimum stack size allowed for DP processing
	  threads despite what is requested in the module init IPC
	  ext_init payload. If the stack size requested in the IPC is
	  smaller than this, then the value defined here takes over.

config CROSS_CORE_STREAM
	bool "Enable cross-core connected pipelines"
	default y if IPC_MAJOR_4
	help
	  Enables support for pipelines from different cores to be
	  connected together cross-core. So stream can travel from one
	  core to another. Note, this is different from "multicore"
	  support. In SOF "multicore" support means different streams
	  can be processed on different cores, however, each stream
	  is processed entirely on single core.
```

## test/ztest/unit/audio/crossover/testcase.yaml
```yaml
# SPDX-License-Identifier: BSD-3-Clause
#
# Copyright(c) 2026 Intel Corporation.
#
# Crossover audio component unit tests
#

common:
  tags:
    - SOF
    - unit_test
    - audio
    - crossover
  integration_platforms:
    - native_sim
  arch_exclude: xtensa

tests:
  sof.unit.audio.crossover:
    platform_allow:
      - native_sim
```

## test/ztest/unit/audio/crossover_blob/testcase.yaml
```yaml
# SPDX-License-Identifier: BSD-3-Clause

common:
  tags:
    - SOF
    - unit_test
    - audio
    - crossover
  integration_platforms:
    - native_sim
  arch_exclude: xtensa

tests:
  sof.unit.audio.crossover_blob:
    platform_allow:
      - native_sim
```

## test/ztest/unit/audio/drc/testcase.yaml
```yaml
# SPDX-License-Identifier: BSD-3-Clause
#
# Copyright(c) 2026 Intel Corporation.

common:
  tags:
    - SOF
    - unit_test
    - audio
    - drc
  integration_platforms:
    - native_sim
  arch_exclude: xtensa

tests:
  sof.unit.audio.drc:
    platform_allow:
      - native_sim
```

## test/ztest/unit/audio/selector/testcase.yaml
```yaml
# SPDX-License-Identifier: BSD-3-Clause
#
# Copyright(c) 2026 Intel Corporation.

common:
  tags:
    - SOF
    - unit_test
    - audio
    - selector
  integration_platforms:
    - native_sim
  arch_exclude: xtensa

tests:
  sof.unit.audio.selector:
    platform_allow:
      - native_sim
```

## test/ztest/unit/math/mu_law/testcase.yaml
```yaml
# SPDX-License-Identifier: BSD-3-Clause
#
# Copyright(c) 2026 Intel Corporation. All rights reserved.

tests:
  sof.unit.math.mu_law:
    tags: [math, mu_law, codec, g711]
    platform_allow: native_sim
    integration_platforms:
      - native_sim
    build_only: false
```
