## src/audio/stft_process/Kconfig
```kconfig
# SPDX-License-Identifier: BSD-3-Clause

config COMP_STFT_PROCESS
	tristate "STFT processing component"
	default n
	select MATH_FFT
	select MATH_32BIT_FFT
	select MATH_FFT_MULTI
	help
	  Select for stft_process component. STFT acronym means
	  short term Fourier transform. It converts audio
	  to multiple FFTs with selected FFT size, hop, and
	  window function. Possible signal processing can be
	  done in it in frequency domain for FFTs that is
	  efficient for more complex signal processing techniques.
	  The component converts then the frequency domain
	  version of signal back to normal PCM audio stream
	  with inverse STFT.

if COMP_STFT_PROCESS

config STFT_PROCESS_MAGNITUDE_PHASE
	bool "Convert FFTs to polar magnitude and phase"
	default n
	help
	  Select for processing in polar magnitude and phase
	  domain. Such complex values format is common for
	  frequency domain signal processing.

endif # COMP_STFT_PROCESS
```

## src/audio/stft_process/Kconfig.simd
```kconfig
# SPDX-License-Identifier: BSD-3-Clause

comment "STFT Process optimization level select"

choice "COMP_STFT_PROCESS_SIMD_LEVEL_SELECT"
	prompt "Choose which SIMD level is used for the STFT Process module"
	depends on COMP_STFT_PROCESS
	default COMP_STFT_PROCESS_HIFI_MAX

	config COMP_STFT_PROCESS_HIFI_MAX
		prompt "SIMD will be selected by toolchain pre-defined header"
		bool
		help
			When this is selected, the optimization level will be
			determined by the toolchain pre-defined macros in the
			core isa header file.

	config COMP_STFT_PROCESS_HIFI_3
		prompt "Choose HIFI3 intrinsic optimized STFT Process module"
		bool
		help
			This option is used to build HIFI3 intrinsic optimized
			STFT Process code.

	config COMP_STFT_PROCESS_HIFI_NONE
		prompt "Choose generic C STFT Process module, no HIFI SIMD involved"
		bool
		help
			This option is used to build STFT Process
			with generic C code.
endchoice
```

## src/audio/tdfb/Kconfig
```kconfig
# SPDX-License-Identifier: BSD-3-Clause

config COMP_TDFB
	tristate "TDFB component"
	depends on COMP_MODULE_ADAPTER
	select MATH_FIR
	select MATH_IIR_DF1
	select SQRT_FIXED
	select CORDIC_FIXED
	select COMP_BLOB
	default m if LIBRARY_DEFAULT_MODULAR
	default y
	help
	  Select for time domain fixed beamformer (TDFB) component. The
          beamformer component enhances microphone capture by spatial
          suppression of noise and improvement of signal-to-noise ratio of
          capture from beam direction. The component is essentially a generic
          single rate FIR filter bank that performs microphone array
          directivity enhancement when programmed with suitable configuration
          for channels selection, channel filter coefficients, and output
          streams mixing.
```

## src/audio/template_comp/Kconfig
```kconfig
# SPDX-License-Identifier: BSD-3-Clause

config COMP_TEMPLATE_COMP
	tristate "Template_comp example component"
	default y
	help
	  Select for template_comp component. Reason for existence
	  is to provide a minimal component example and use as
	  placeholder in processing pipelines. As example processing
	  it swaps or reverses the channels when the switch control
	  is enabled.
```

## src/audio/tfmicro/Kconfig
```kconfig
# SPDX-License-Identifier: BSD-3-Clause

config COMP_TFMICRO
	tristate "Tensorflow Micro component"
	default n
	help
	  Select for Tensorflow component support.
```

## src/audio/tone/Kconfig
```kconfig
# SPDX-License-Identifier: BSD-3-Clause

config COMP_TONE
	tristate "Tone component"
	default m if LIBRARY_DEFAULT_MODULAR
	default y
	depends on COMP_MODULE_ADAPTER
	depends on IPC_MAJOR_4
	select CORDIC_FIXED
	help
	  Select for Tone component. This component is used to generate
	  audio tones (sine waves) at specified frequencies when the Tone
	  mode is enabled. The two other modes it supports are silence where
	  it generates 0s and passthrough where the input is passed to the
	  output. Warning: This component is untested with IPC_MAJOR_3 and
	  is unavailable.
```

## src/audio/up_down_mixer/Kconfig
```kconfig
# SPDX-License-Identifier: BSD-3-Clause

config COMP_UP_DOWN_MIXER
	bool "UP_DOWN_MIXER component"
        depends on IPC_MAJOR_4
        help
         Select for Up Down Mixer component Conversions supported:
         Up/Downmixing for stereo output:
         1, 2, 2.1, 3.0, 3.1, Quatro, 4.0, 5.0, 5.1, 7.1 -> 2
         Upmixing for multichannel output:
         1, 2 -> 5.1
         2 -> 7.1
         Downmixing for mono output:
         4.0, Quatro, 3.1, 2 -> 1
```

## src/audio/volume/Kconfig
```kconfig
# SPDX-License-Identifier: BSD-3-Clause

	config COMP_VOLUME
		bool "Volume component"
		default y
		help
		  Select for Volume component

if COMP_VOLUME

config COMP_VOLUME_WINDOWS_FADE
       bool "Windows Fade shape volume transitions support"
       help
         This option enables volume ramp shape that follows
	 power of 1.75. The shape is not linear, not logarithmic.
	 The power function uses a lookup table that consumes
	 256 bytes. The topology must set volume ramp token to
	 SOF_VOLUME_WINDOWS_FADE for the volume instance to use
	 this ramp shape.

config COMP_VOLUME_LINEAR_RAMP
       bool "Linear ramp volume transitions support"
	   default y
       help
         This option enables volume linear ramp shape.

config COMP_PEAK_VOL
       bool "Report peak vol data to host"
	   default y
	   depends on IPC_MAJOR_4
       help
         This option enables reporting to host peak vol regs.
         See: struct ipc4_peak_volume_regs

choice "PEAK_METER_UPDATE_PERIOD_CHOICE"
	prompt "The periods(ms) of updating peak meter value"
	default PEAK_METER_UPDATE_10MS
	depends on COMP_PEAK_VOL

	config PEAK_METER_UPDATE_1MS
		bool "1ms"
		help
		  Update the peak meter value every 1ms

	config PEAK_METER_UPDATE_10MS
		bool "10ms"
		help
		  Update the peak meter value every 10ms

	config PEAK_METER_UPDATE_100MS
		bool "100ms"
		help
		  Update the peak meter value every 100ms

	config PEAK_METER_UPDATE_1000MS
		bool "1000ms"
		help
		  Update the peak meter value every 1000ms
	endchoice

config PEAK_METER_UPDATE_PERIOD
	int
	depends on COMP_PEAK_VOL
	default 1 if PEAK_METER_UPDATE_1MS
	default 10 if PEAK_METER_UPDATE_10MS
	default 100 if PEAK_METER_UPDATE_100MS
	default 1000 if PEAK_METER_UPDATE_1000MS
	help
	  Decide which period of update the peak volume meter value

config COMP_GAIN
	bool "GAIN component"
	default y
	depends on IPC_MAJOR_4
	help
	  This option enables gain to change volume. It works
	  as peak volume without updating peak vol to host

endif # volume
```

## src/audio/volume/Kconfig.simd
```kconfig
# SPDX-License-Identifier: BSD-3-Clause

comment "volume optimization level select"

choice "VOLUME_SIMD_LEVEL_SELECT"
	prompt "choose which SIMD level used for volume module"
	depends on COMP_VOLUME
	default VOLUME_HIFI_MAX

	config VOLUME_HIFI_MAX
		prompt "SIMD will selected by toolchain pre-defined header"
		bool
		help
			When this was selected, optimization level will be determined
			by toolchain pre-defined macros in core isa header file.

	config VOLUME_HIFI_5
		prompt "choose HIFI5 intrinsic optimized volume module"
		bool
		help
			This option used to build HIFI5 optimized volume code

	config VOLUME_HIFI_4
		prompt "choose HIFI4 intrinsic optimized volume module"
		bool
		help
			This option used to build HIFI4 optimized volume code

	config VOLUME_HIFI_3
		prompt "choose HIFI3 intrinsic optimized volume module"
		bool
		help
			This option used to build HIFI3 intrinsic optimized volume code

	config VOLUME_HIFI_NONE
		prompt "choose generic C volume module, no HIFI SIMD involved"
		bool
		help
			This option used to build volume generic code.
endchoice
```

## src/debug/debug_stream/Kconfig
```kconfig
# SPDX-License-Identifier: BSD-3-Clause

config SOF_DEBUG_STREAM_SLOT
	bool "Enable SOF debug stream debug window slot"
	help
	  Debug stream is an abstract stream of records of debug
	  information from SOF system that are streamed from SOF DSP
	  to the host side for decoding and presentation. This option
	  enables transferring the records from DSP to host over a
	  debug window slot.

if SOF_DEBUG_STREAM_SLOT

config SOF_DEBUG_STREAM_SLOT_NUMBER
	int "Debug window slot where to put debug stream slot"
	default 3
	range 0 14
	help
	  Which debug slot to reserve for Debug Stream. Remember to map
	  the slot with MEMORY_WIN_2_SIZE in soc/intel/intel_adsp/Kconfig,
	  in Zephyr source tree. The slots are 4k in size and one slot is
	  used for descriptors, so for slot 3 to be mapped, the WIN_2_SIZE
	  must be (1 + 3) * 4k = 16k or greater.

config SOF_DEBUG_STREAM_THREAD_INFO
	bool "Enable Zephyr thread info reporting through Debug-Stream"
	select INIT_STACKS
	select THREAD_MONITOR
	select THREAD_STACK_INFO
	select THREAD_RUNTIME_STATS
	help
	  This activates Zephyr thread info reporting through
	  Debug-Stream. Thread info reports some basic live data from
	  the Zephyr threads, like stack usage high-water-mark and CPU
	  usage. Please select THREAD_NAME=y for the thread names more
	  than just hex numbers.

config SOF_DEBUG_STREAM_THREAD_INFO_INTERVAL
	int "Thread information collection interval in seconds"
	depends on SOF_DEBUG_STREAM_THREAD_INFO
	default 2
	range 1 10
	help
	  Decides how often thread info runs and checks execution cycle
	  statistics and stack usage.

endif
```

## src/debug/tester/Kconfig
```kconfig
# SPDX-License-Identifier: BSD-3-Clause

config COMP_TESTER
	tristate "tester module"
	default n
	depends on IPC_MAJOR_4
	help
	  Build a tester module. To be used in continuous 
	  integration process for special test cases that
	  require a test code injected into the system itself
```

## src/drivers/Kconfig
```kconfig
# SPDX-License-Identifier: BSD-3-Clause

menu "Drivers"

rsource "intel/Kconfig"

rsource "dw/Kconfig"

rsource "imx/Kconfig"

config DUMMY_DMA
	bool "Dummy DMA (software DMA driver)"
	default n
	depends on HOST_PTABLE
	help
	  Select this to enable the software-based host DMA implementation.
	  This driver does all the transfers between host memory and DSP local
	  buffer memory using regular memcpy. It requires direct access to the
	  host memory.

	  If unsure, select "n".

config IPC_POLLING
	bool "Enable IPC Polling support"
	default n
	help
	  Select this to enable support for simple IPC polling. This allows
	  users like GDB and boot loader a simple IPC mechanism that does not
	  depend on IRQ or a scheduler.

	  If unsure, select "n".

endmenu # "Drivers"
```

## src/drivers/dw/Kconfig
```kconfig
# SPDX-License-Identifier: BSD-3-Clause

config DW
	bool
	default n
	help
	  This has to be selected if platform supports Designware features.

if DW

config DW_DMA
	bool "Designware DMA driver"
	default n
	help
	  Select this to enable support for the Designware DMA controller.

config DW_DMA_AGGREGATED_IRQ
	bool
	default n
	help
	  Some platforms cannot register interrupt per DW-DMA channel
	  and have the possibility only to register interrupts per
	  DMA controller, which require manual handling of aggregated
	  irq.

	  Any platforms with DW-DMA aggregated interrupts support
	  should set this.

config DW_SPI
	bool
	default n

config DW_GPIO
	bool
	default n

endif # DW
```

## src/drivers/imx/Kconfig
```kconfig
# SPDX-License-Identifier: BSD-3-Clause

config IMX_EDMA
	bool "i.MX EDMA driver"
	default n
	depends on IMX
	help
	  Select this to enable support for i.MX EDMA DMA controller.

config IMX_SDMA
	bool "i.MX SDMA driver"
	default n
	depends on IMX
	help
	  Select this to enable support for i.MX SDMA DMA controller.

config IMX_ESAI
	bool "i.MX ESAI driver"
	default n
	depends on IMX
	help
	  Select this to enable support for i.MX ESAI IP.

config IMX_MICFIL
	bool "i.MX MICFIL PDM driver"
	default n
	depends on IMX
	help
	  Select this to enable support for i.MX MICFIL PDM IP. This block implements
	  the required digital interface to provide a 24-bits audio signal from a PDM
	  microphone bitstream in a configurable output sampling rate

config IMX_INTERRUPT_IRQSTEER
	bool
	default n
	help
	  This has to be selected for i.MX NXP platform that have irqsteer.
	  It enables NXP platforms-specific features.

config IMX_INTERRUPT_GENERIC
	bool
	default n
	help
	  This has to be selected for i.MX NXP platform that do not have irqsteer.
	  It enables NXP platforms-specific features.

config HAVE_SDMA_FIRMWARE
	bool "Enable SDMA firmware load"
	default n
	help
	  Select this to load SDMA firmware to enable additional functionality
          for SDMA controller.

if HAVE_SDMA_FIRMWARE
	config SDMA_SCRIPT_CODE
		string "SDMA script code path"
		help
		  This option is a string and provides the path where to find the sdma script
		  code header.
endif
```
