## src/audio/mixin_mixout/Kconfig
```kconfig
# SPDX-License-Identifier: BSD-3-Clause

config COMP_MIXIN_MIXOUT
	tristate "Mixin_mixout component"
	depends on IPC_MAJOR_4
	default m if METEORLAKE
	default y
	help
	  Select for Mixin_mixout component

choice "MIXIN_MIXOUT_SIMD_LEVEL_SELECT"
	prompt "choose which SIMD level used for MIXIN_MIXOUT module"
	depends on COMP_MIXIN_MIXOUT
	default MIXIN_MIXOUT_HIFI_MAX

	config MIXIN_MIXOUT_HIFI_MAX
		prompt "Max HiFi level available in the toolchain"
		bool
		help
			When this was selected, optimization level will be determined
			by toolchain.

	config MIXIN_MIXOUT_HIFI_5
		prompt "choose HIFI4 intrinsic optimized MIXIN_MIXOUT module"
		bool
		help
			This option used to build HIFI4 optimized MIXIN_MIXOUT code

	config MIXIN_MIXOUT_HIFI_4
		prompt "choose HIFI4 intrinsic optimized MIXIN_MIXOUT module"
		bool
		help
			This option used to build HIFI4 optimized MIXIN_MIXOUT code

	config MIXIN_MIXOUT_HIFI_3
		prompt "choose HIFI3 intrinsic optimized MIXIN_MIXOUT module"
		bool
		help
			This option used to build HIFI3 intrinsic optimized MIXIN_MIXOUT code

	config MIXIN_MIXOUT_HIFI_NONE
		prompt "choose generic C MIXIN_MIXOUT module, no HIFI SIMD involved"
		bool
		help
			This option used to build MIXIN_MIXOUT generic code.
endchoice
```

## src/audio/module_adapter/Kconfig
```kconfig
# SPDX-License-Identifier: BSD-3-Clause

menu "Processing modules"
	visible if COMP_MODULE_ADAPTER

	config MODULE_MEMORY_API_CONTAINER_CHUNK_SIZE
		int "Number of memory containers to allocate at once"
		default 16
		help
		  The per module resource containers are allocated in
		  chunks. The unused containers are kept in free
		  list. When the free list is empty the amount of
		  containers to allocate at once is selected by this
		  config option.

	config CADENCE_CODEC
		bool "Cadence codec"
		default n
		help
		  Select for codecs which conforms to the Cadence API.
		  This will cause codec adapter component to include header
		  files specific to CADENCE base codecs.

if CADENCE_CODEC
	config CADENCE_CODEC_WRAPPER
		bool 'Cadence codec wrapper'
		default n
		help
		  Select for cadence_codec_api wrapper function that will allow
		  users to call into codecs which conforms to the Cadence API without
		  explicitly knowing/using the entry function symbol name.

	if CADENCE_CODEC_WRAPPER
		config CADENCE_CODEC_WRAPPER_LIB
		string "Cadence codec wrapper library name"
		help
		  This option is a string and takes the full name of the codec wrapper library binary.
	endif

	config CADENCE_CODEC_AAC_DEC
		bool "Cadence AAC decoder"
		default n
		help
		  Select for Cadence AAC decoder support.
		  This will cause Cadence codec to include Cadence AAC library
		  api symbol.

	if CADENCE_CODEC_AAC_DEC
		config CADENCE_CODEC_AAC_DEC_LIB
		string "Cadence AAC decoder library name"
		help
		  This option is a string and takes the full name of the AAC decoder library binary.
	endif

	config CADENCE_CODEC_BSAC_DEC
		bool "Cadence BSAC decoder"
		default n
		help
		  Select for Cadence BSAC decoder support.
		  This will cause Cadence codec to include Cadence BSAC library
		  api symbol.

	if CADENCE_CODEC_BSAC_DEC
		config CADENCE_CODEC_BSAC_DEC_LIB
		string "Cadence BSAC decoder library name"
		help
		  This option is a string and takes the full name of the BSAC decoder library
	endif

	config CADENCE_CODEC_DAB_DEC
		bool "Cadence DAB decoder"
		default n
		help
		  Select for Cadence DAB decoder support.
		  This will cause Cadence codec to include Cadence DAB library
		  api symbol.

	if CADENCE_CODEC_DAB_DEC
		config CADENCE_CODEC_DAB_DEC_LIB
		string "Cadence DAB decoder library name"
		help
		  This option is a string and takes the full name of the DAB library binary.
	endif

	config CADENCE_CODEC_DRM_DEC
		bool "Cadence DRM decoder"
		default n
		help
		  Select for Cadence DRM decoder support.
		  This will cause Cadence codec to include Cadence DRM library
		  api symbol.

	if CADENCE_CODEC_DRM_DEC
		config CADENCE_CODEC_DRM_DEC_LIB
		string "Cadence DRM decoder library name"
		help
		  This option is a string and takes the full name of the DRM library binary.
	endif

	config CADENCE_CODEC_MP3_DEC
		bool "Cadence MP3 decoder"
		default n
		help
		  Select for Cadence MP3 decoder support.
		  This will cause Cadence codec to include Cadence MP3 library
		  api symbol.

	if CADENCE_CODEC_MP3_DEC
		config CADENCE_CODEC_MP3_DEC_LIB
		string "Cadence MP3 decoder library name"
		help
		  This option is a string and takes the full name of the MP3 library binary.
	endif

	config CADENCE_CODEC_MP3_ENC
		bool "Cadence MP3 encoder"
		default n
		help
		  Select for Cadence MP3 encoder support.
		  This will cause Cadence codec to include Cadence MP3 library
		  api symbol.

	if CADENCE_CODEC_MP3_ENC
		config CADENCE_CODEC_MP3_ENC_LIB
		string "Cadence MP3 encoder library name"
		help
		  This option is a string and takes the full name of the MP3 library binary.
	endif

	config CADENCE_CODEC_SBC_DEC
		bool "Cadence SBC decoder"
		default n
		help
		  Select for Cadence SBC decoder support.
		  This will cause Cadence codec to include Cadence SBC library
		  api symbol.

	if CADENCE_CODEC_SBC_DEC
		config CADENCE_CODEC_SBC_DEC_LIB
		string "Cadence SBC decoder library name"
		help
		  This option is a string and takes the full name of the SBC library binary.
	endif


	config CADENCE_CODEC_VORBIS_DEC
		bool "Cadence VORBIS decoder"
		default n
		help
		  Select for Cadence VORBIS decoder support.
		  This will cause Cadence codec to include Cadence VORBIS library
		  api symbol.

	if CADENCE_CODEC_VORBIS_DEC
		config CADENCE_CODEC_VORBIS_DEC_LIB
		string "Cadence VORBIS decoder library name"
		help
		  This option is a string and takes the full name of the VORBIS library binary.
	endif

	config CADENCE_CODEC_SRC_PP
		bool "Cadence SRC polyphase"
		default n
		help
		  Select for Cadence SRC polyphase support.
		  This will cause Cadence codec to include Cadence SRC library
		  api symbol.

	if CADENCE_CODEC_SRC_PP
		config CADENCE_CODEC_SRC_PP_LIB
		string "Cadence SRC polyphase library name"
		help
		  This option is a string and takes the full name of the SRC library binary.
	endif

endif # Cadence

	config PASSTHROUGH_CODEC
		bool "Passthrough codec"
		default n
		help
		  Select for a passthrough API codec implementation.
		  This will cause codec adapter component to include header
		  files specific to PASSTHROUGH base codecs.

	config WAVES_CODEC
	tristate "Waves codec"
	default n
	help
		Select to include Waves codec. Waves codec implements MaxxEffect API.
		API definition together with pre-compiled library is shared by Waves Audio Ltd.
		If library is not provided will result in compilation error.
		For more information, contact consumer@waves.com.

	config WAVES_CODEC_STUB
	bool "Waves codec stub"
	depends on WAVES_CODEC != "n"
	default y if COMP_STUBS
	default n
	help
		Select to build the waves codec with a stub file. This should only be used for
		testing or CI.

	config INTEL_MODULES
	bool "Intel modules"
	default n
	depends on LIBRARY_MANAGER
	help
		Select for a Intel modules API implementation.
		This will cause module adapter component to include IADK module
		codec code. It will work only when LIBRARY_MANAGER is enabled.
endmenu
```

## src/audio/multiband_drc/Kconfig
```kconfig
# SPDX-License-Identifier: BSD-3-Clause

config COMP_MULTIBAND_DRC
	depends on COMP_IIR && COMP_CROSSOVER && COMP_DRC
	tristate "Multiband Dynamic Range Compressor component"
	select CORDIC_FIXED
	select COMP_BLOB
	default m if LIBRARY_DEFAULT_MODULAR
	help
	  Select for Multiband Dynamic Range Compressor (DRC) component. It
	  consists of Emphasis Equalizer, n-way Crossover Filter, per-band DRC,
	  and Deemphasis Equalizer.
```

## src/audio/mux/Kconfig
```kconfig
# SPDX-License-Identifier: BSD-3-Clause

config COMP_MUX
	tristate "MUX component"
	select COMP_BLOB
	depends on COMP_MODULE_ADAPTER
	default y
	help
	  Select for MUX component
```

## src/audio/nxp/Kconfig
```kconfig
# SPDX-License-Identifier: BSD-3-Clause

config COMP_NXP_EAP
	tristate "NXP EAP Component"
	help
	  Select for NXP Essential Audio Processing Component.
	  The EAP is a bundle of audio processing blocks for enhancing the tonal
	  and spatial perception of sound in audio applications.

config COMP_NXP_EAP_STUB
	tristate "NXP EAP Component stub"
	depends on COMP_NXP_EAP
	help
	  Select for NXP EAP stub support.
```

## src/audio/phase_vocoder/Kconfig
```kconfig
# SPDX-License-Identifier: BSD-3-Clause

config COMP_PHASE_VOCODER
	tristate "Phase Vocoder component"
	default n
	select MATH_FFT
	select MATH_32BIT_FFT
	help
	  Select for phase_vocoder component. The component provides
	  render speed control in range 0.5-2.0x. The pitch is
	  preserved in audio waveform stretch or shorten. The module
	  is using a frequency domain algorithm in STFT domain to
	  interpolate magnitude and phase of output IFFT frames from
	  input FFT frames.
```

## src/audio/rtnr/Kconfig
```kconfig
# SPDX-License-Identifier: BSD-3-Clause

config COMP_RTNR
	tristate "RTNR component"
	select COMP_BLOB
	select COMP_RTNR_STUB if COMP_STUBS
	help
	  Select for Realtek noise reduction/suppression(NR/NS) component.
	  Noise Suppression technology reduces stationary and transient noises in
	  single-channel speech signals, which increases the signal-to-noise ratio,
	  improves speech intelligibility and reduces listening fatigue. It estimates
	  ambient noise and signal levels and then passes or attenuates the signals
	  according to improve signal-to-noise ratios. The feature links to a
	  proprietary binary libSOF_RTK_MA_API.a, libSuite_rename.a, libNet.a and libPreset.a.
	  Please contact antz0525@realtek.com for any question about the binary.

config COMP_RTNR_STUB
	bool "RTNR component stub"
	select COMP_BLOB
	depends on COMP_RTNR
	help
	  Stub out the RTNR library for testing and CI purposes.
```

## src/audio/selector/Kconfig
```kconfig
# SPDX-License-Identifier: BSD-3-Clause

config COMP_SEL
	tristate "Channel selector component"
	default m if LIBRARY_DEFAULT_MODULAR
	default y
	help
	  Select for SEL component
```

## src/audio/smart_amp/Kconfig
```kconfig
# SPDX-License-Identifier: BSD-3-Clause

config COMP_SMART_AMP
	bool "Smart Amplifier component"
	select COMP_BLOB
	help
	  Select for Smart Amp component. This component protect the speaker
	  from overheating and excursion violation. This consists of two parts
	  which are feedforward processing block running on playback thread
	  and feedback processing block running on capture thread with amp
	  current and voltage feedback. The internal design of this component
	  depends on the applied Amplifier HW solution, which should be provided
	  by the solution supplier respectively.

if COMP_SMART_AMP

choice
        prompt "Smart Amplifier solution applied"
        default PASSTHRU_AMP
	help
	  The selection for Smart Amplifier component implementation
	  will depend on the Amplifier solution supplier. It is fair
	  to treat the supported solutions as mutually exclusive ones.
	  There should be no more than one solution selected per build
	  config. When Smart Amplifier is present but no solution is
	  supported, the passthrough mode will be applied as default.

	config PASSTHRU_AMP
		bool "Stream Passthrough"
		help
		  The default option as the passthrough mode while no other
		  solution is applied. While selected, the feed-forward input
		  frames will be passed to output after channel remapping. No
		  gain or latency will be produced. In the meanwhile, the
		  feedback input frames will be consumed but dropped directly.

	config MAXIM_DSM
		bool "Maxim DSM solution"
		select MAXIM_DSM_STUB if COMP_STUBS
		help
		  Select to apply Maxim DSM(Dynamic Speaker Management) solution
		  for Smart Amplifier. As the third-party supply, the
		  pre-compiled library provided by Maxim will be required for
		  building the FW binary with this option enabled. The library
		  itself should be statically linked with the SoF FW binary image.

endchoice

	config MAXIM_DSM_STUB
		bool "Maxim DSM solution"
		depends on MAXIM_DSM
		help
		  Select to build the Maxim DSM adapter with a stub library. This
		  should only be used for CI and testing.

endif
```

## src/audio/sound_dose/Kconfig
```kconfig
# SPDX-License-Identifier: BSD-3-Clause

config COMP_SOUND_DOSE
	tristate "Sound Dose module"
	default m if LIBRARY_DEFAULT_MODULAR
	depends on COMP_MODULE_ADAPTER
	depends on IPC_MAJOR_4
	select MATH_IIR
	select MATH_IIR_DF1
	select MATH_EXP
	help
	  Select this for Sound Dose SOF module. The purpose is
	  to calculate for audio playback MEL values (momentary
	  sound exposure level) to provide to user space the data
	  to compute the sound dose CSD as defined in EN 50332-3.
```

## src/audio/src/Kconfig
```kconfig
# SPDX-License-Identifier: BSD-3-Clause

config COMP_SRC
	tristate "SRC component"
	default m if LIBRARY_DEFAULT_MODULAR
	default y
	help
	  Select for SRC component

if COMP_SRC

config COMP_SRC_LITE
	bool "SRC_LITE component"
	default y
	help
	  Select for SRC_LITE component
	  which only supports a subset of conversions
	  supported by the SRC module:
	  48 -> 16kHz
	  44.1 -> 16 kHz
	  32 -> 16 kHz
	  44.1 -> 48

choice
        prompt "SRC coefficient set"
        default COMP_SRC_STD

config COMP_SRC_STD
	bool "Full conversions support and high quality"
	help
	  This coefficients set supports a large number of conversions
	  with 8 - 192 kHz input and 8 - 48 kHz output. The coefficients
	  are 32 bits for high conversion quality. The coefficients
	  storage consume 79 kB. The runtime needs 8 kB. Use this if there
	  is critical quality usage for SRC like music via headphones and
	  need high sample rates.

config COMP_SRC_SMALL
	bool "Smaller conversions support and high quality"
	help
	  This coefficients set supports a small number of conversions
	  with 8 - 48 kHz input and output. The coefficients are 32 bits
	  for high conversion quality. The coefficients storage consumes
	  30 kB RAM. Runtime needs 4 kB. Use this if there is critical
	  quality usage for SRC like music via headphones.

config COMP_SRC_TINY
	bool "Reduced conversions support and reduced quality"
	help
	  This coefficients set supports a minimum number of conversions
	  with 8 - 48 kHz input and output. The coefficients are 16 bits
	  that restricts the possible stop-attenuation and could cause
	  some audible aliasing. The bandwidth of the filters is restricted
	  so the full 20 kHz band is not met even if sample rate would
	  allow. The coefficients storage consumes 5 kB RAM. The runtime
	  needs 6 kB. Use this to save RAM for other applications when SRC
	  has no critical usage or when only need with lower quality
	  endpoint like miniature speakers.

config COMP_SRC_IPC4_FULL_MATRIX
	bool "Full IPC4 conversions matrix support and high quality"
	help
	  This coefficients set supports a large number of conversions
	  with 8 - 192 kHz input 8 - 192 kHz output. The 32 bits coefficients
	  storate consumes 241 kB. The runtime needs 9 kB. Use this to
	  make the full conversions set available for IPC4 build.

endchoice

endif # SRC
```
