## src/audio/volume/Kconfig
```kconfig
# SPDX-License-Identifier: BSD-3-Clause

config COMP_VOLUME
	tristate "Volume component"
	default m if LIBRARY_DEFAULT_MODULAR
	default y
	help
	  Select for Volume component

if COMP_VOLUME

rsource "Kconfig.simd"

config COMP_VOLUME_WINDOWS_FADE
       bool "Windows Fade shape volume transitions support"
       help
         This option enables volume ramp shape that follows
	 power of 1.75. The shape is not linear, not logarithmic.
	 The power function uses a lookup table that consumes
	 256 bytes. The topology must set volume ramp token to
	 SOF_VOLUME_WINDOWS_FADE for the volume instance to use
	 this ramp shape.

config COMP_VOLUME_LINEAR_RAMP
       bool "Linear ramp volume transitions support"
	   default y
       help
         This option enables volume linear ramp shape.

config COMP_PEAK_VOL
       bool "Report peak vol data to host"
	   default y
	   depends on IPC_MAJOR_4
       help
         This option enables reporting to host peak vol regs.
         See: struct ipc4_peak_volume_regs

choice "PEAK_METER_UPDATE_PERIOD_CHOICE"
	prompt "The periods(ms) of updating peak meter value"
	default PEAK_METER_UPDATE_10MS
	depends on COMP_PEAK_VOL

	config PEAK_METER_UPDATE_1MS
		bool "1ms"
		help
		  Update the peak meter value every 1ms

	config PEAK_METER_UPDATE_10MS
		bool "10ms"
		help
		  Update the peak meter value every 10ms

	config PEAK_METER_UPDATE_100MS
		bool "100ms"
		help
		  Update the peak meter value every 100ms

	config PEAK_METER_UPDATE_1000MS
		bool "1000ms"
		help
		  Update the peak meter value every 1000ms
	endchoice

config PEAK_METER_UPDATE_PERIOD
	int
	depends on COMP_PEAK_VOL
	default 1 if PEAK_METER_UPDATE_1MS
	default 10 if PEAK_METER_UPDATE_10MS
	default 100 if PEAK_METER_UPDATE_100MS
	default 1000 if PEAK_METER_UPDATE_1000MS
	help
	  Decide which period of update the peak volume meter value

config COMP_GAIN
	bool "GAIN component"
	default y
	depends on IPC_MAJOR_4
	help
	  This option enables gain to change volume. It works
	  as peak volume without updating peak vol to host

config COMP_GAIN_FAULT_INJECT
	bool "DEBUG: inject a CPU exception in gain process() on one core"
	default y
	depends on COMP_GAIN
	help
	  Debug-only fault injection. After COMP_GAIN_FAULT_INJECT_PERIODS
	  calls to the gain module's process() on a gain instance created
	  on core COMP_GAIN_FAULT_INJECT_CORE, execute an illegal
	  instruction ("ill" on Xtensa) from the LL thread context to
	  raise an IllegalInstruction CPU exception. Never enable in
	  production builds.

config COMP_GAIN_FAULT_INJECT_CORE
	int "Core on which gain instances fault"
	default 1
	depends on COMP_GAIN_FAULT_INJECT
	help
	  Only gain instances whose IPC4 core_id equals this value
	  inject the fault; gain instances on other cores run normally.

config COMP_GAIN_FAULT_INJECT_PERIODS
	int "Number of process() calls before the fault"
	default 1000
	depends on COMP_GAIN_FAULT_INJECT
	help
	  Number of process() invocations per gain instance before the
	  exception is raised. With a 1 ms LL period, 1000 is about 1 s
	  of streaming, so the stream is fully running when it faults.

endif # volume
```

## src/kernel/probe/Kconfig
```kconfig
# SPDX-License-Identifier: BSD-3-Clause

# Probe configs

menu "Probe"

config PROBE
	tristate "Probes enabled"
	default m if LIBRARY_DEFAULT_MODULAR
	default y if CAVS
	help
	  Select for enabling debug probes to extract/inject buffers

if PROBE != n

config PROBE_POINTS_MAX
	int "Maximum probe points"
	depends on PROBE
	default 16
	help
	  Define maximum number of probes, extraction and injection combined.

config PROBE_DMA_MAX
	int "Maximum injection probe DMAs attached"
	depends on PROBE
	default 0
	help
	  Define maximum number of injection DMAs.

config PROBE_IMX_HOST_DMA
	bool "Extract probe data to a host ring through the i.MX host DMA"
	depends on PROBE && IMX && IPC_MAJOR_3 && ZEPHYR_NATIVE_DRIVERS
	help
	  On i.MX IPC3 platforms the host DMA is configured by the firmware,
	  so the kernel passes the host ring address in the PROBE_INIT
	  stream_tag and the DSP writes extraction data directly into it.
	  The firmware publishes a write counter in the ring header for the
	  kernel to poll, since the host DMA reports no position.

endif

endmenu
```

## test/ztest/unit/audio/aria/testcase.yaml
```yaml
# SPDX-License-Identifier: BSD-3-Clause

common:
  tags:
    - SOF
    - unit_test
    - audio
    - aria
  integration_platforms:
    - native_sim
  arch_exclude: xtensa

tests:
  sof.unit.audio.aria:
    platform_allow:
      - native_sim
```

## test/ztest/unit/audio/selector/testcase.yaml
```yaml
# SPDX-License-Identifier: BSD-3-Clause
#
# Copyright(c) 2026 Intel Corporation.

common:
  tags:
    - SOF
    - unit_test
    - audio
    - selector
  integration_platforms:
    - native_sim
  arch_exclude: xtensa

tests:
  sof.unit.audio.selector:
    platform_allow:
      - native_sim
  sof.unit.audio.selector.ipc3:
    platform_allow:
      - native_sim
    extra_args:
      - CONF_FILE=prj_ipc3.conf
```

## test/ztest/unit/audio/webrtc_aec/testcase.yaml
```yaml
# SPDX-License-Identifier: BSD-3-Clause
#
# Copyright(c) 2026 Intel Corporation.

common:
  tags:
    - SOF
    - unit_test
    - audio
    - webrtc_aec
  integration_platforms:
    - native_sim
  arch_exclude: xtensa

tests:
  sof.unit.audio.webrtc_aec:
    platform_allow:
      - native_sim
```
