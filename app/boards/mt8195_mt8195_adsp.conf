## app/boards/mt8195_mt8195_adsp.conf
```kconfig
# Boilerplate.  Because the "Platform" is a kconfig "choice" (of which
# "MTK" is an member), it can't be selected automatically from other
# kconfigs, nor expressed as a default.  Don't put anything else here.
# Board-level config goes in Zephyr (and ideally in DTS).  App-level
# config goes in prj.conf.
CONFIG_MTK=y
```

## app/boards/native_sim.conf
```kconfig
CONFIG_ZEPHYR_POSIX=y
CONFIG_SYS_HEAP_BIG_ONLY=y
CONFIG_ZEPHYR_NATIVE_DRIVERS=y
CONFIG_ZEPHYR_LOG=y
CONFIG_ZTEST=y
CONFIG_SOF_BOOT_TEST_STANDALONE=y
CONFIG_NUMBERS_VECTOR_FIND=y
CONFIG_NUMBERS_NORM=y
```

## app/boards/native_sim_libfuzzer.conf
```kconfig
# See https://docs.zephyrproject.org/latest/build/kconfig/setting.html#initial-conf

CONFIG_ZEPHYR_POSIX=y
CONFIG_ASSERT=y
CONFIG_EXCEPTION_DEBUG=y
CONFIG_ARCH_POSIX_TRAP_ON_FATAL=y
CONFIG_SYS_HEAP_BIG_ONLY=y
CONFIG_ZEPHYR_NATIVE_DRIVERS=y
CONFIG_ARCH_POSIX_LIBFUZZER=y
CONFIG_ZEPHYR_POSIX_FUZZ_TICKS=100

# Override incompatible options found in sof/app/prj.conf
# to silence build time warnings
# (strange why these are in app/prj.conf but not our problem here)
CONFIG_SMP_BOOT_DELAY=n
CONFIG_SCHED_CPU_MASK_PIN_ONLY=n
```

## app/boards/qemu_xtensa_dc233c_mmu.conf
```kconfig
# SPDX-License-Identifier: BSD-3-Clause
CONFIG_IPC_MAJOR_4=y
CONFIG_USERSPACE=y
#CONFIG_ZTEST=y
CONFIG_TEST_USERSPACE=y
CONFIG_MM_DRV=y
CONFIG_ZEPHYR_NATIVE_DRIVERS=y
CONFIG_SOF_USERSPACE_LL=y
#CONFIG_SOF_BOOT_TEST_STANDALONE=y

# Ensure the kernel can exit QEMU on shutdown/panic
#CONFIG_REBOOT=y
#CONFIG_ZTEST_STACK_SIZE=4096
CONFIG_COMP_UP_DOWN_MIXER=y
CONFIG_COMP_MODULE_ADAPTER=y
CONFIG_PASSTHROUGH_CODEC=y
CONFIG_COMP_ARIA=y
CONFIG_COMP_MFCC=y
CONFIG_COMP_CROSSOVER=y
CONFIG_COMP_DCBLOCK=y
CONFIG_COMP_IIR=y
CONFIG_COMP_DRC=y
CONFIG_COMP_MULTIBAND_DRC=y
CONFIG_COMP_LEVEL_MULTIPLIER=y
CONFIG_COMP_RTNR=y
CONFIG_COMP_RTNR_STUB=y
CONFIG_COMP_SMART_AMP=y
CONFIG_COMP_TDFB=y
CONFIG_COMP_STFT_PROCESS=y
CONFIG_COMP_GOOGLE_RTC_AUDIO_PROCESSING=y
CONFIG_GOOGLE_RTC_AUDIO_PROCESSING_MOCK=y
CONFIG_COMP_GOOGLE_CTC_AUDIO_PROCESSING=y
CONFIG_GOOGLE_CTC_AUDIO_PROCESSING_MOCK=y
CONFIG_COMP_IGO_NR=y
CONFIG_COMP_IGO_NR_STUB=y
CONFIG_COMP_NXP_EAP=y
CONFIG_COMP_NXP_EAP_STUB=y
CONFIG_CPP=y
CONFIG_STD_CPP17=y
CONFIG_COMP_SOUND_DOSE=y
```

## src/arch/Kconfig
```kconfig
# SPDX-License-Identifier: BSD-3-Clause

# Generic architecture configs

rsource "$(ARCH)/Kconfig"
```

## src/arch/host/Kconfig
```kconfig
# SPDX-License-Identifier: BSD-3-Clause

# Host architecture configs

config CORE_COUNT
	int
	default MP_MAX_NUM_CPUS
	help
	  Number of used cores
```

## src/arch/host/configs/library_defconfig
```kconfig
CONFIG_COMP_ARIA=y
CONFIG_COMP_ASRC=y
CONFIG_COMP_CROSSOVER=y
CONFIG_COMP_DCBLOCK=y
CONFIG_COMP_DRC=y
CONFIG_COMP_FIR=y
CONFIG_COMP_GOOGLE_RTC_AUDIO_PROCESSING=y
CONFIG_COMP_GOOGLE_CTC_AUDIO_PROCESSING=y
CONFIG_COMP_IIR=y
CONFIG_COMP_IGO_NR=y
CONFIG_COMP_MFCC=y
CONFIG_COMP_MODULE_ADAPTER=y
CONFIG_COMP_MULTIBAND_DRC=y
CONFIG_COMP_MUX=y
CONFIG_COMP_RTNR=y
CONFIG_COMP_SEL=y
CONFIG_COMP_SRC=y
CONFIG_COMP_SRC_IPC4_FULL_MATRIX=y
CONFIG_COMP_STUBS=y
CONFIG_COMP_TDFB=y
CONFIG_COMP_VOLUME=y
CONFIG_COMP_VOLUME_LINEAR_RAMP=y
CONFIG_COMP_VOLUME_WINDOWS_FADE=y
CONFIG_DEBUG_MEMORY_USAGE_SCAN=n
CONFIG_IPC_MAJOR_3=y
CONFIG_IPC_MAJOR_4=n
CONFIG_LIBRARY=y
CONFIG_LIBRARY_STATIC=y
CONFIG_MATH_IIR_DF2T=y
CONFIG_TRACEV=y
CONFIG_XT_RUN=y
```

## src/arch/host/configs/plugin_ipc4_defconfig
```kconfig
CONFIG_IPC_MAJOR_4=y
CONFIG_LIBRARY=y
CONFIG_TRACEV=y
CONFIG_DEBUG_MEMORY_USAGE_SCAN=n
CONFIG_COMP_CROSSOVER=y
CONFIG_COMP_DRC=y
CONFIG_COMP_MULTIBAND_DRC=y
CONFIG_COMP_SRC=y
CONFIG_COMP_SRC_IPC4_FULL_MATRIX=y
CONFIG_COMP_MFCC=y
CONFIG_COMP_GAIN=y
CONFIG_COMP_VOLUME_WINDOWS_FADE=y
CONFIG_COMP_MODULES_SO=y
CONFIG_COMP_MODULE_ADAPTER=y
CONFIG_COMP_MIXER=y
CONFIG_IPC4_GATEWAY=n
CONFIG_COMP_DAI_GROUP=n
CONFIG_FORMAT_S16LE=y
CONFIG_FORMAT_S32LE=y
CONFIG_FORMAT_S24LE=y
CONFIG_COMP_PEAK_VOL=n
CONFIG_COMP_MODULE_SHARED_LIBRARY_BUILD=y
```

## src/arch/xtensa/Kconfig
```kconfig
# SPDX-License-Identifier: BSD-3-Clause

# Xtensa-specific architecture configs

config NO_SECONDARY_CORE_ROM
	bool
	default n
	help
	  Indicates that secondary core have rom, alternate reset vector
	  is needed if not

config WAKEUP_HOOK
	bool
	default n
	help
	  Enables hook that is called and after coming back from WAITI.
	  This config should be selected by other platform-level configs.
	  Platforms that use it, have to implement hook function
	  platform_interrupt_on_wakeup.
```

## src/arch/xtensa/configs/apollolake_defconfig
```kconfig
CONFIG_APOLLOLAKE=y
CONFIG_INTEL_DMIC=y
CONFIG_DMIC_HW_IOCLK=19200000
CONFIG_INTEL_SSP=y
CONFIG_CORE_COUNT=1
CONFIG_LP_MEMORY_BANKS=2
CONFIG_HP_MEMORY_BANKS=8
CONFIG_PERFORMANCE_COUNTERS=y
CONFIG_COMP_SRC_SMALL=y
CONFIG_COMP_TDFB=n
CONFIG_COMP_TONE=n
CONFIG_COMP_LEGACY_INTERFACE=y
```

## src/arch/xtensa/configs/baytrail_defconfig
```kconfig
CONFIG_BAYTRAIL=y
CONFIG_COMP_TEST_KEYPHRASE=n
CONFIG_COMP_KPB=n
CONFIG_COMP_SEL=n
CONFIG_COMP_MUX=n
CONFIG_COMP_FIR=n
CONFIG_COMP_IIR=n
CONFIG_COMP_DCBLOCK=n
CONFIG_COMP_SRC=n
CONFIG_COMP_ASRC=n
CONFIG_COMP_TDFB=n
CONFIG_COMP_TONE=n
CONFIG_OPTIMIZE_FOR_SIZE=y
CONFIG_HAVE_AGENT=n
CONFIG_DEBUG_MEMORY_USAGE_SCAN=n
CONFIG_TRACE_FILTERING_ADAPTIVE=n
```

## src/arch/xtensa/configs/baytrail_gcc_defconfig
```kconfig
CONFIG_BAYTRAIL=y
CONFIG_COMP_TEST_KEYPHRASE=n
CONFIG_COMP_KPB=n
CONFIG_COMP_SEL=n
CONFIG_COMP_MUX=n
CONFIG_COMP_FIR=n
CONFIG_COMP_IIR=n
CONFIG_COMP_ASRC=n
```

## src/arch/xtensa/configs/broadwell_defconfig
```kconfig
CONFIG_BROADWELL=y
CONFIG_COMP_ASRC=n
CONFIG_HAVE_AGENT=n
CONFIG_COMP_SRC_TINY=y
CONFIG_COMP_LEGACY_INTERFACE=y
```

## src/arch/xtensa/configs/cherrytrail_defconfig
```kconfig
CONFIG_CHERRYTRAIL=y
CONFIG_COMP_TEST_KEYPHRASE=n
CONFIG_COMP_KPB=n
CONFIG_COMP_SEL=n
CONFIG_COMP_MUX=n
CONFIG_COMP_FIR=n
CONFIG_COMP_IIR=n
CONFIG_COMP_TONE=n
CONFIG_COMP_DCBLOCK=n
CONFIG_COMP_ASRC=n
CONFIG_COMP_SRC=n
CONFIG_COMP_TDFB=n
CONFIG_COMP_TONE=n
CONFIG_COMP_SWITCH=n
CONFIG_OPTIMIZE_FOR_SIZE=y
CONFIG_HAVE_AGENT=n
CONFIG_DEBUG_MEMORY_USAGE_SCAN=n
CONFIG_TRACE_FILTERING_ADAPTIVE=n
CONFIG_COMP_LEGACY_INTERFACE=y
CONFIG_PCM_CONVERTER_FORMAT_FLOAT=n
CONFIG_FORMAT_FLOAT=n
CONFIG_COMP_BLOB=n
CONFIG_COMP_DAI_GROUP=n
```

## src/arch/xtensa/configs/icelake_defconfig
```kconfig
CONFIG_ICELAKE=y
CONFIG_INTEL_DMIC=y
CONFIG_DMIC_HW_IOCLK=38400000
CONFIG_INTEL_SSP=y
CONFIG_INTEL_ALH=y
CONFIG_LP_MEMORY_BANKS=1
CONFIG_HP_MEMORY_BANKS=47
CONFIG_COMP_LEGACY_INTERFACE=y
```

## src/arch/xtensa/configs/imx8m_defconfig
```kconfig
CONFIG_IMX8M=y
CONFIG_HAVE_AGENT=n
CONFIG_FORMAT_CONVERT_HIFI3=n
CONFIG_KPB_FORCE_COPY_TYPE_NORMAL=n
CONFIG_MATH_DECIBELS=y
CONFIG_NUMBERS_NORM=y
```

## src/arch/xtensa/configs/jasperlake_defconfig
```kconfig
CONFIG_ICELAKE=y
CONFIG_RIMAGE_SIGNING_SCHEMA="jsl"
CONFIG_INTEL_DMIC=y
CONFIG_DMIC_HW_IOCLK=38400000
CONFIG_INTEL_SSP=y
CONFIG_CORE_COUNT=2
CONFIG_LP_MEMORY_BANKS=1
CONFIG_HP_MEMORY_BANKS=16
CONFIG_COMP_LEGACY_INTERFACE=y
```

## src/arch/xtensa/configs/kabylake_defconfig
```kconfig
CONFIG_APOLLOLAKE=y
CONFIG_RIMAGE_SIGNING_SCHEMA="kbl"
CONFIG_INTEL_DMIC=y
CONFIG_INTEL_SSP=y
CONFIG_LP_MEMORY_BANKS=2
CONFIG_HP_MEMORY_BANKS=30
```

## src/arch/xtensa/configs/mt8365_defconfig
```kconfig
CONFIG_MT8365=y
CONFIG_CORE_COUNT=1
CONFIG_XT_VIRTUAL_OPS=1
CONFIG_COMP_VOLUME=y
CONFIG_COMP_SRC=n
CONFIG_COMP_FIR=n
CONFIG_COMP_IIR=n
CONFIG_COMP_DCBLOCK=n
CONFIG_COMP_TDFB=n
CONFIG_COMP_TONE=n
CONFIG_COMP_MIXER=n
CONFIG_COMP_MUX=n
CONFIG_COMP_KPB=n
CONFIG_COMP_SEL=n
CONFIG_COMP_ASRC=n
```

## src/arch/xtensa/configs/mtl_defconfig
```kconfig
CONFIG_METEORLAKE=y
CONFIG_ACE=y
CONFIG_ACE_VERSION_1_0=y
CONFIG_RIMAGE_SIGNING_SCHEMA="mtl"
CONFIG_INTEL_DMIC=y
CONFIG_INTEL_DMIC_NHLT=y
CONFIG_INTEL_SSP=y
CONFIG_INTEL_ALH=y
CONFIG_CORE_COUNT=2
CONFIG_LP_MEMORY_BANKS=0
CONFIG_HP_MEMORY_BANKS=22
CONFIG_L1_DRAM=n
CONFIG_L1_DRAM_MEMORY_BANKS=0
CONFIG_L1_DRAM_MEMORY_BANK_SIZE=0
CONFIG_IPC_MAJOR_4=y
CONFIG_COMP_VOLUME_WINDOWS_FADE=y
CONFIG_FORMAT_CONVERT_HIFI3=n
```
