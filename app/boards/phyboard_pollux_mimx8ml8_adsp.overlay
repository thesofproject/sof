/*
 * Copyright (C) 2026 PHYTEC Messtechnik GmbH
 *
 * SPDX-License-Identifier: Apache-2.0
 */

/ {
	host_dma: dma {
		compatible = "nxp,sof-host-dma";
		dma-channels = <32>;
		#dma-cells = <0>;
	};
};

&sdma3 {
	status = "okay";
};

/* SAI2 on the expansion connector, e.g. TLV320 codec on the PEB-AV-10 */
&sai2 {
	rx-fifo-watermark = <65>;
	tx-fifo-watermark = <65>;
	fifo-depth = <128>;
	/* Rx provides BCLK/FS, the frame sync is only routed on SAI2_RXFS */
	tx-sync-mode = <1>;
	status = "okay";
};
