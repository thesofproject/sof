## src/audio/bt_codec/Kconfig
```kconfig
# SPDX-License-Identifier: BSD-3-Clause

config COMP_BT_CODEC
	bool "Bluetooth Transparent Mode DSP Codec components (LC3, mSBC, G.722, SB4)"
	depends on COMP_MODULE_ADAPTER && IPC_MAJOR_4
	help
	  Select to include Bluetooth Transparent Mode (0x03) DSP audio codec
	  offload components for SSP2-BT playback and capture pipelines.
	  Provides bt_lc3 (Zephyr liblc3 7.5 ms codec), bt_msbc (Bluetooth HFP
	  H2-framed mSBC), bt_g722 (ITU-T Rec. G.722 SB-ADPCM), and bt_sb4
	  (experimental 4-band tree-QMF subband ADPCM).
```

## src/audio/dcblock/Kconfig
```kconfig
# SPDX-License-Identifier: BSD-3-Clause

config COMP_DCBLOCK
	tristate "DC Blocking Filter component"
	default m if LIBRARY_DEFAULT_MODULAR
	default y
	help
	  Select for DC Blocking Filter component. This component filters out
	  the DC offset which often originates from a microphone's output.

choice
	prompt "DC Blocking Filter HIFI level"
	depends on COMP_DCBLOCK
	default DCBLOCK_HIFI_MAX if XTENSA
	default DCBLOCK_ARM_SIMD if ARM
	default DCBLOCK_HIFI_NONE

config DCBLOCK_ARM_SIMD
	bool "ARM SIMD and FPU accelerated DCBLOCK"
	depends on ARM
	help
	  Select for ARMv7E-M SIMD and FPU accelerated DC Blocking Filter.

config DCBLOCK_HIFI_MAX
	bool "Max level available in the toolchain"

config DCBLOCK_HIFI_4
	bool "HIFI4 DCBLOCK"

config DCBLOCK_HIFI_3
	bool "HIFI3 DCBLOCK"

config DCBLOCK_HIFI_NONE
	bool "Generic DCBLOCK, no HIFI"

endchoice
```

## src/audio/eq_iir/Kconfig.simd
```kconfig
# SPDX-License-Identifier: BSD-3-Clause

config EQ_IIR_ARM_SIMD
	bool "ARM SIMD and block-accelerated EQ IIR"
	default y
	depends on ARM
	help
	  Select for ARMv7E-M SIMD and block-accelerated EQ IIR implementation

config EQ_IIR_RISCV_SIMD
	bool "RISC-V SIMD and block-accelerated EQ IIR"
	default y
	depends on SOF_CONFIG_RISCV_SIMD
	help
	  Select for RISC-V SIMD and block-accelerated EQ IIR implementation
```

## src/audio/equalizer/Kconfig
```kconfig
# SPDX-License-Identifier: BSD-3-Clause

config COMP_EQUALIZER
	tristate "FFmpeg Parametric Equalizer (equalizer) module"
	default n
	help
	  Select to enable the parametric biquad equalizer module.
	  Provides 3-band acoustic tuning for laptop speakers and headsets.

if COMP_EQUALIZER

config COMP_EQUALIZER_STUB
	bool "Build with pass-through stub backend"
	default n
	help
	  Select to build with the pass-through stub backend instead of real equalizer.

endif # COMP_EQUALIZER
```

## src/audio/ffmpeg_dec/Kconfig
```kconfig
# SPDX-License-Identifier: BSD-3-Clause

config COMP_FFMPEG_DEC
	tristate "FFmpeg (libavcodec) audio decoder"
	select COMP_FFMPEG_DEC_STUB if COMP_STUBS
	help
	  Select to include the FFmpeg audio decoder module. It wraps
	  libavcodec decoders behind the SOF module interface, decoding a
	  compressed elementary stream to PCM. The real backend cross-builds
	  libavcodec/libavutil/libswresample from the FFmpeg source pulled in
	  by west (see west.yml), enabling only the decoders selected below.
	  Without the source (or for CI) select COMP_FFMPEG_DEC_STUB to build
	  the dependency-free passthrough stub.

config COMP_FFMPEG_DEC_STUB
	bool "FFmpeg decoder stub backend"
	depends on COMP_FFMPEG_DEC
	help
	  Build the ffmpeg_dec module against a dependency-free passthrough
	  backend instead of libavcodec. Intended for testing and CI so the
	  SOF glue and LLEXT packaging can be validated without the FFmpeg
	  source or a cross-built archive.

if COMP_FFMPEG_DEC && !COMP_FFMPEG_DEC_STUB

comment "FFmpeg decoders to build (footprint scales with selection)"

config FFMPEG_DEC_FLAC
	bool "FLAC decoder"
	default y
	help
	  Lossless integer decoder. Smallest footprint, no floating-point
	  math. Enables --enable-decoder=flac in the libavcodec build.

config FFMPEG_DEC_AAC
	bool "AAC-LC decoder (fixed-point)"
	help
	  AAC Low Complexity decoder (fixed-point 32-bit integer). Enables
	  --enable-decoder=aac_fixed in the libavcodec build. Operates in
	  pure 32-bit fixed-point arithmetic without software-float emulation.

config FFMPEG_DEC_OPUS
	bool "Opus decoder"
	help
	  Opus (SILK+CELT) decoder. Pulls in the single-precision float math
	  layer. Enables --enable-decoder=opus in the libavcodec build.

config FFMPEG_DEC_MP3
	bool "MP3 decoder"
	help
	  MPEG-1/2 Layer III decoder. Enables --enable-decoder=mp3 and the
	  mpegaudio parser in the libavcodec build. Uses the float math layer.

config FFMPEG_DEC_ALAC
	bool "ALAC decoder"
	help
	  Apple Lossless Audio Codec (ALAC) decoder. Pure 16/24-bit integer
	  lossless decoder with no floating-point math dependency. Enables
	  --enable-decoder=alac in the libavcodec build for compress playback
	  streams requesting SND_AUDIOCODEC_ALAC.

comment "FFmpeg encoders to build (footprint scales with selection)"

config FFMPEG_ENC_MP3
	bool "MP3 encoder (libshine, fixed-point)"
	help
	  MPEG-1 Layer III encoder via libshine, a small fixed-point encoder
	  (west-pinned; FFmpeg has no native MP3 encoder). Cross-builds libshine
	  and enables --enable-libshine --enable-encoder=libshine. Fixed-point, so
	  no float math dependency. Selected at runtime for compress capture streams
	  requesting SND_AUDIOCODEC_MP3.

config FFMPEG_ENC_AAC
	bool "AAC-LC encoder (vo-aacenc, fixed-point)"
	help
	  MPEG-4 AAC Low Complexity encoder via vo-aacenc, a lightweight 32-bit
	  fixed-point integer encoder (west-pinned). Pure integer fixed-point, no
	  float math dependency. Output is a standard ADTS AAC elementary stream.
	  Selected at runtime for compress capture streams requesting
	  SND_AUDIOCODEC_AAC.

# Selected automatically when any encoder is enabled. Gates compilation of the
# runtime encode path (ffmpeg-encode.c).
config FFMPEG_ENC
	bool
	default y if FFMPEG_ENC_MP3 || FFMPEG_ENC_AAC

comment "FFmpeg audio filters to build (libavfilter)"
	depends on IPC_MAJOR_4

config FFMPEG_FILTER_AFFTDN
	bool "FFT noise reduction (afftdn)"
	depends on IPC_MAJOR_4
	help
	  FFT-based audio denoiser (libavfilter af_afftdn). Builds libavfilter
	  with abuffer, abuffersink, aformat and afftdn, plus the avfilter-graph
	  runtime path (ffmpeg-filter.c).

config FFMPEG_FILTER_ALIMITER
	bool "Lookahead peak limiter (alimiter)"
	depends on IPC_MAJOR_4
	help
	  Lookahead brickwall peak limiter (libavfilter af_alimiter). Prevents
	  digital clipping and provides speaker protection. Builds libavfilter
	  with abuffer, abuffersink, aformat and alimiter, plus the avfilter-graph
	  runtime path (ffmpeg-filter.c).

# Turns on libavfilter in the FFmpeg cross-build when any filter is selected.
config FFMPEG_BUILD_AVFILTER
	bool
	default y if FFMPEG_FILTER_AFFTDN || FFMPEG_FILTER_ALIMITER

# Gates compilation of the runtime avfilter-graph path (ffmpeg-filter.c).
config FFMPEG_FILTER
	bool
	default y if FFMPEG_BUILD_AVFILTER

choice
	prompt "Default FFmpeg audio filter"
	depends on FFMPEG_FILTER
	default FFMPEG_FILTER_DEFAULT_AFFTDN if FFMPEG_FILTER_AFFTDN
	default FFMPEG_FILTER_DEFAULT_ALIMITER if FFMPEG_FILTER_ALIMITER

config FFMPEG_FILTER_DEFAULT_AFFTDN
	bool "FFT noise reduction (afftdn)"
	depends on FFMPEG_FILTER_AFFTDN
	help
	  Select afftdn (FFT noise reduction) as the default libavfilter audio
	  filter when no explicit filter profile or runtime configuration is
	  supplied.

config FFMPEG_FILTER_DEFAULT_ALIMITER
	bool "Lookahead peak limiter (alimiter)"
	depends on FFMPEG_FILTER_ALIMITER
	help
	  Select alimiter (lookahead brickwall peak limiter) as the default
	  libavfilter audio filter when no explicit filter profile or runtime
	  configuration is supplied.

endchoice

# Selected automatically when a decoder or filter that needs IEEE float math is
# built. Gates compilation of the fast single-precision libm (fastmathf.c).
config FFMPEG_DEC_FLOAT_MATH
	bool
	default y if FFMPEG_DEC_AAC || FFMPEG_DEC_OPUS || FFMPEG_DEC_MP3 || FFMPEG_BUILD_AVFILTER

config FFMPEG_DEC_COLD_SPLIT
	bool "Place cold FFmpeg code (av_cold init/setup) in DRAM [EXPERIMENTAL]"
	depends on COLD_STORE_EXECUTE_DRAM
	help
	  EXPERIMENTAL. Build libavcodec with -mtext-section-literals and rename
	  FFmpeg's cold functions (its av_cold init/table-generation code, which GCC
	  emits into .text.unlikely) into SOF's .cold section so the LLEXT loader
	  places them in DRAM, keeping the hot per-frame decode in fast SRAM.

	  Measured cold code is small (~1 KB for FLAC, ~26 KB for AAC) because
	  FFmpeg only marks init functions av_cold. Placing that much cold code in a
	  -shared LLEXT currently hits Xtensa linker limits (cold->hot call8 range
	  needs -mlongcalls; the orphan .cold lands at a bad LMA and overlaps .hash),
	  so this is off by default pending proper cold-region placement in the LLEXT
	  memory map. See git history / TESTING notes.

endif # COMP_FFMPEG_DEC && !COMP_FFMPEG_DEC_STUB
```

## src/audio/mfcc/Kconfig
```kconfig
# SPDX-License-Identifier: BSD-3-Clause

config COMP_MFCC
	tristate "MFCC component"
	depends on COMP_MODULE_ADAPTER
	select CORDIC_FIXED
	select MATH_32BIT_FFT
	select MATH_32BIT_MEL_FILTERBANK
	select MATH_AUDITORY
	select MATH_DCT
	select MATH_DECIBELS
	select MATH_FFT
	select MATH_MATRIX
	select MATH_WINDOW
	select NATURAL_LOGARITHM_FIXED
	select NUMBERS_NORM
	select SQRT_FIXED
	default m if LIBRARY_DEFAULT_MODULAR
	default y
	help
	  This option enables build of a Mel-frequency cepstral coefficients
	  (MFCC) audio features extractor component. It converts the input
	  audio stream into encoded audio data for cepstral coefficients.
	  The characteristic of the audio features are defined in the binary
	  control blob. Directory tools/tune/mfcc contains a tool to create
	  the configurations.

if COMP_MFCC

config COMP_MFCC_PCAN
	bool "Enable PCAN (Per-Channel AGC Normalization) in MFCC"
	default n
	select MATH_PCAN
	help
	  Select to build MFCC with PCAN (Per-Channel Automatic Gain Control
	  Normalization) support on the Mel filterbank energies. PCAN performs
	  dynamic per-channel gain control and piecewise polynomial root
	  compression to suppress stationary noise and enhance transients,
	  producing normalized features suitable for direct int8 quantization
	  downstream (e.g. microWakeWord). The topology PCAN configuration
	  fields are ignored when this option is disabled.

config COMP_MFCC_DEBUG_TRACE
	bool "Verbose per-process debug traces in MFCC"
	default n
	help
	  Enable MFCC per-process debug prints in the hot path.

endif # COMP_MFCC
```

## src/audio/microwakeword/Kconfig
```kconfig
# SPDX-License-Identifier: BSD-3-Clause

config COMP_MWW
	tristate "microWakeWord keyword-spotting component"
	depends on SOF_STAGING
	depends on CPP
	depends on STD_CPP17
	depends on IPC_MAJOR_4
	help
	  Select for microWakeWord component support. This module runs a
	  TensorFlow Lite Micro streaming keyword-spotting model (based on
	  OHF-Voice's micro-wake-word project) on MFCC features and wakes
	  the host via KPB/WoV when the wake word is detected.

if COMP_MWW

config COMP_MWW_DEBUG_TRACE
	bool "Verbose per-hop / per-inference debug traces"
	default n
	help
	  Enable mww per-hop and per-inference debug prints in the hot path.
	  Leave disabled for production and normal capture tuning.

config COMP_MWW_HIFI_NNLIB
	bool "Use HiFi4 nnlib optimized TFLM kernels"
	default y
	help
	  Build the CONV_2D, DEPTHWISE_CONV_2D, FULLY_CONNECTED, QUANTIZE,
	  DEQUANTIZE and other model operators from the TFLM Xtensa kernels
	  backed by the Cadence HiFi4 nnlib. Only effective when building
	  with the xt-clang toolchain; other toolchains use the portable
	  reference kernels.

config COMP_MWW_PROFILE
	bool "Per-operator inference cycle profiling"
	default n
	help
	  Measure CCOUNT cycles spent in each TFLM operator of the MWW
	  model and log the per-inference averages in the stream shutdown
	  summary. Only effective for the static (non-LLEXT) build.

config COMP_MWW_MODEL_FROM_CONTROL
	bool "Load MWW model from bytes control instead of built-in header"
	default n
	help
	  When enabled, the MWW wake-word model is loaded from a runtime
	  or topology configuration data blob via binary kcontrol (bytes control)
	  instead of using the static mww_model_data embedded in the firmware image.

choice COMP_MWW_MODEL
	prompt "microWakeWord built-in model"
	default COMP_MWW_MODEL_PIPELINE_ID
	help
	  Select which wake-word model to build into the firmware image.
	  By default, models are selected per pipeline ID at runtime, which
	  compiles all default models into the image. Alternatively, a single
	  built-in model can be selected at build time to save memory.

config COMP_MWW_MODEL_PIPELINE_ID
	bool "Select model via pipeline ID"
	help
	  Select model dynamically based on pipeline/slot ID (slot 0: strawberry,
	  slot 1: hi_intel, slot 2: orange). All default models from available
	  header files are built into the firmware image.

config COMP_MWW_MODEL_HI_INTEL
	bool "Hi Intel"
	help
	  Build only the "Hi Intel" keyword model (mww_model_data_hi_intel.h) into
	  the firmware image and use it as the built-in model.

config COMP_MWW_MODEL_HEY_JARVIS
	bool "Hey Jarvis"
	help
	  Build only the "Hey Jarvis" keyword model (mww_model_data_hey_jarvis.h) into
	  the firmware image and use it as the built-in model.

config COMP_MWW_MODEL_STRAWBERRY
	bool "Strawberry"
	help
	  Build only the "Strawberry" keyword model (mww_model_data_strawberry.h) into
	  the firmware image and use it as the built-in model.

config COMP_MWW_MODEL_ORANGE
	bool "Orange"
	help
	  Build only the "Orange" keyword model (mww_model_data_orange.h) into
	  the firmware image and use it as the built-in model.

config COMP_MWW_MODEL_BANANA
	bool "Banana"
	help
	  Build only the "Banana" keyword model (mww_model_data_banana.h) into
	  the firmware image and use it as the built-in model.

endchoice

config COMP_MWW_FAKE_WAKE_MS
	int "Fake wake timer delay in ms when wovdebug kcontrol is armed (0 = default 5000ms)"
	default 0
	help
	  Test aid for automated wake-on-voice testing. When the wovdebug volatile
	  switch kcontrol is set on a WOV slot, the firmware arms a timer with this
	  duration (or 5000ms if set to 0) after the pipeline is active/triggered.
	  Upon expiration, it fires a synthetic keyword detection to wake the host
	  and drain the KPB buffer, then auto-clears the wovdebug kcontrol back to 0.

config COMP_MWW_PCAN
	bool "Expect PCAN-normalized MFCC input"
	default y if COMP_MFCC_PCAN
	depends on COMP_MFCC_PCAN
	help
	  Select when the upstream MFCC component runs with PCAN
	  (Per-Channel AGC Normalization) enabled. In that mode the Mel
	  filterbank energies arriving at MWW are already normalized to the
	  int8 dynamic range, so the in-component peak-tracking AGC and the
	  Q9.23->Q1.7 requantization step are compiled out and each Mel value
	  is clamped and cast directly to int8. Leave disabled for the
	  classic non-PCAN MFCC pipeline that relies on MWW's built-in AGC.

endif # COMP_MWW
```

## src/audio/mixer/Kconfig
```kconfig
# SPDX-License-Identifier: BSD-3-Clause

config COMP_MIXER
	bool "Mixer component"
	depends on IPC_MAJOR_3
	default y
	help
	  Select for Mixer component

config MIXER_ARM_SIMD
	bool "ARM SIMD optimized Mixer component"
	default y
	depends on ARM && COMP_MIXER
	help
	  Select for ARMv7E-M SIMD optimized Mixer processing functions.
```

## src/audio/steamaudio/Kconfig
```kconfig
# SPDX-License-Identifier: Apache-2.0
#
# Copyright (c) 2017-2024 Valve Corporation. All rights reserved.
# Copyright (c) 2026 Intel Corporation. All rights reserved.

config COMP_STEAMAUDIO
	tristate "Steam Audio spatial offload component"
	default m if LIBRARY_DEFAULT_MODULAR
	depends on IPC_MAJOR_4
	help
	  Select for Steam Audio spatial audio offload component.
	  Provides 3D binaural HRTF spatialization, direct sound modeling,
	  3-band biquad IIR filtering, 8-channel Householder Feedback Delay
	  Network (FDN) reverberation, 1st-order Ambisonics rotation/decoding,
	  and on-chip DSP BVH ray tracing for real-time room acoustic simulation.
```
