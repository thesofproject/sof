## app/boards/esp32p4_function_ev_board_esp32p4_hpcore.conf
```kconfig
# Target Platform & SOF Core
CONFIG_PLATFORM_ESP32P4=y
CONFIG_SOF_FULL_ZEPHYR_APPLICATION=y
CONFIG_ZEPHYR_NATIVE_DRIVERS=y
CONFIG_SYS_HEAP_BIG_ONLY=y

# Zephyr DAI Drivers for ESP32
CONFIG_DAI=y
CONFIG_DAI_ESPRESSIF_I2S=y
CONFIG_DAI_ESPRESSIF_PDM=y
CONFIG_PINCTRL=y
CONFIG_DMA=y

# Audio Processing Modules
CONFIG_COMP_VOLUME=y
CONFIG_COMP_IIR=y
CONFIG_COMP_FIR=y
CONFIG_COMP_DRC=y
CONFIG_COMP_TDFB=y
CONFIG_COMP_USB_AUDIO=y

# USB Device Stack Next & UAC2 Class
CONFIG_USB_DEVICE_STACK_NEXT=y
CONFIG_CDC_ACM_SERIAL_INITIALIZE_AT_BOOT=n
CONFIG_USBD_AUDIO2_CLASS=y
CONFIG_UDC_ENABLE_SOF=y
CONFIG_UDC_DWC2_DMA=n
CONFIG_UDC_DWC2_PTI=y
CONFIG_UDC_BUF_COUNT=256
CONFIG_UDC_BUF_POOL_SIZE=16384

# USB Device Identification
CONFIG_SAMPLE_USBD_VID=0x303A
CONFIG_SAMPLE_USBD_PID=0x4002
CONFIG_SAMPLE_USBD_MANUFACTURER="Espressif"
CONFIG_SAMPLE_USBD_PRODUCT="ESP32-P4 Dual UAC2 Audio"

# System Resources & Memory
CONFIG_MAIN_STACK_SIZE=8192
CONFIG_SYSTEM_WORKQUEUE_STACK_SIZE=4096
CONFIG_USBD_THREAD_STACK_SIZE=4096
CONFIG_UDC_DWC2_STACK_SIZE=4096
CONFIG_UDC_WORKQUEUE_STACK_SIZE=4096
CONFIG_ISR_STACK_SIZE=4096
CONFIG_HW_STACK_PROTECTION=n
CONFIG_HEAP_MEM_POOL_SIZE=32768

# Logging & UART Console
CONFIG_LOG=y
CONFIG_LOG_DEFAULT_LEVEL=3
CONFIG_LOG_MAX_LEVEL=4
CONFIG_SOF_LOG_LEVEL_INF=y
CONFIG_DAI_LOG_LEVEL_INF=y
CONFIG_USBD_UAC2_LOG_LEVEL_INF=y
CONFIG_UDC_DRIVER_LOG_LEVEL_INF=y
CONFIG_LOG_MODE_IMMEDIATE=y
CONFIG_LOG_BACKEND_UART=y
CONFIG_PRINTK=y
CONFIG_EARLY_CONSOLE=y

# Interactive Shell
CONFIG_SHELL=y
CONFIG_SHELL_BACKENDS=y
CONFIG_SHELL_BACKEND_SERIAL=y
CONFIG_SHELL_PROMPT_UART="sof:~$ "

# SOF Low Latency Scheduler Statistics Logging (Every 1s)
CONFIG_SCHEDULE_LL_STATS_LOG=y
CONFIG_SCHEDULE_LL_STATS_LOG_EVERY_OTHER_WINDOW=n
CONFIG_SCHEDULE_LL_STATS_LOG_WINDOW_SIZE=10
```

## app/boards/imx8mp_evk_mimx8ml8_adsp_ipc4.conf
```kconfig
CONFIG_IMX8M=y
CONFIG_HAVE_AGENT=n
CONFIG_FORMAT_CONVERT_HIFI3=n
CONFIG_KPB_FORCE_COPY_TYPE_NORMAL=n
CONFIG_DMA=y
CONFIG_DMA_NXP_SDMA=y
CONFIG_DAI_NXP_MICFIL=y
CONFIG_TRACE=n
CONFIG_SHARED_INTERRUPTS=y
CONFIG_ZEPHYR_NATIVE_DRIVERS=y
CONFIG_SAI_HAS_MCLK_CONFIG_OPTION=y
CONFIG_CLOCK_CONTROL_FIXED_RATE_CLOCK=y

# IPC4 overlay for i.MX8MP
CONFIG_IPC_MAJOR_4=y

# single core
CONFIG_CROSS_CORE_STREAM=n
CONFIG_COMP_PEAK_VOL=n
```

## app/boards/intel_adsp_ace30_ptl.conf
```kconfig
CONFIG_PANTHERLAKE=y
CONFIG_RIMAGE_SIGNING_SCHEMA="ptl"

# SOF / IPC configuration
CONFIG_IPC_MAJOR_4=y

# SOF / audio pipeline and module settings
CONFIG_COMP_TESTER=n
CONFIG_COMP_SRC_IPC4_FULL_MATRIX=y
CONFIG_FORMAT_CONVERT_HIFI3=n
CONFIG_COMP_DRC=y
CONFIG_COMP_TDFB=y
CONFIG_COMP_MULTIBAND_DRC=y
CONFIG_COMP_ARIA=y
CONFIG_COMP_MUX=y
CONFIG_PCM_CONVERTER_FORMAT_S24_3LE=y
CONFIG_COMP_GOOGLE_RTC_AUDIO_PROCESSING=n
CONFIG_COMP_STFT_PROCESS=n

# WOV Arbiter, KPB, Mixin/Mixout and Sample Detector
CONFIG_COMP_MIXIN_MIXOUT=y
CONFIG_COMP_WOV_ARBITER=y
CONFIG_COMP_KPB=y
CONFIG_KPB_MAX_BUFF_TIME=2000
CONFIG_COMP_ECNS=y
CONFIG_ECNS_TEST_SIGNAL=y
CONFIG_SOF_STAGING=y
CONFIG_COMP_MFCC=y
CONFIG_COMP_MFCC_PCAN=y
CONFIG_COMP_MWW=y
CONFIG_COMP_MWW_PCAN=y
CONFIG_COMP_MWW_DEBUG_TRACE=y
CONFIG_CPP=y
CONFIG_STD_CPP17=y
CONFIG_COMP_TENSORFLOW=n

# SOF / infrastructure
CONFIG_KCPS_DYNAMIC_CLOCK_CONTROL=n
CONFIG_IDC_TIMEOUT_US=100000
CONFIG_PROBE=y
CONFIG_PROBE_DMA_MAX=2
CONFIG_SOF_TELEMETRY=y
CONFIG_SOF_TELEMETRY_IO_PERFORMANCE_MEASUREMENTS=y
CONFIG_SOF_TELEMETRY_PERFORMANCE_MEASUREMENTS=y
CONFIG_COLD_STORE_EXECUTE_DRAM=y

# SOF / loadable modules
CONFIG_INTEL_MODULES=y
CONFIG_LIBRARY_MANAGER=n

# SOF / logging
CONFIG_SOF_LOG_LEVEL_INF=y

# Zephyr / OS features
# note: CONFIG_DEBUG_COREDUMP is enabled for all Intel targets in
# boards/intel_adsp/Kconfig.defconfig; only the backend and dump-amount
# choices have to be selected per board.
CONFIG_DEBUG_COREDUMP_BACKEND_INTEL_ADSP_MEM_WINDOW=y
CONFIG_DEBUG_COREDUMP_MEMORY_DUMP_MIN=y
CONFIG_COUNTER=y
CONFIG_HEAP_MEM_POOL_SIZE=32768
CONFIG_COMMON_LIBC_MALLOC_ARENA_SIZE=32768
# sof_init (POST_KERNEL) starts the core 0 IDC p4wq thread, needs it created first
CONFIG_P4WQ_INIT_STAGE_EARLY=y

# Zephyr / device drivers
CONFIG_DAI_INIT_PRIORITY=70
CONFIG_DAI_DMIC_HW_IOCLK=38400000
CONFIG_DAI_DMIC_HAS_OWNERSHIP=n
CONFIG_DAI_DMIC_HAS_MULTIPLE_LINE_SYNC=y
CONFIG_DMA_INTEL_ADSP_GPDMA=n
CONFIG_DMA_DW_LLI_POOL_SIZE=50
CONFIG_MEMORY_WIN_2_SIZE=12288
CONFIG_MM_DRV_INTEL_ADSP_TLB_REMAP_UNUSED_RAM=y
CONFIG_MM_DRV_INTEL_VIRTUAL_REGION_COUNT=3
CONFIG_XTENSA_MMU_NUM_L2_TABLES=50
CONFIG_SYS_CLOCK_TICKS_PER_SEC=12000

# Zephyr / power settings
CONFIG_ADSP_IMR_CONTEXT_SAVE=y
CONFIG_PM_PREWAKEUP_CONV_MODE_CEIL=y
CONFIG_PM_DEVICE_RUNTIME_ASYNC=n

# Zephyr / logging
CONFIG_LOG_BACKEND_ADSP=n
CONFIG_LOG_FLUSH_SLEEP_US=5000
CONFIG_WINSTREAM_CONSOLE=n

CONFIG_SYS_HEAP_RUNTIME_STATS=y
CONFIG_SOF_ZEPHYR_HEAP_SIZE=0x80000
```

## app/boards/intel_adsp_cavs25.conf
```kconfig
CONFIG_TIGERLAKE=y
CONFIG_RIMAGE_SIGNING_SCHEMA="tgl-cavs"

# SOF / IPC configuration
CONFIG_IPC_MAJOR_4=y

# SOF / audio pipeline and module settings
CONFIG_COMP_ARIA=y
CONFIG_COMP_CROSSOVER=y
CONFIG_COMP_DRC=y
CONFIG_COMP_MIXIN_MIXOUT=y
CONFIG_COMP_WOV_ARBITER=y
CONFIG_COMP_KPB=y
CONFIG_KPB_MAX_BUFF_TIME=2000
CONFIG_COMP_ECNS=y
CONFIG_ECNS_KPB_MONO_AVG_ALL=y
CONFIG_SOF_STAGING=y
CONFIG_COMP_MFCC=y
CONFIG_COMP_MFCC_PCAN=y
CONFIG_COMP_MWW=y
CONFIG_COMP_MWW_PCAN=y
CONFIG_COMP_MWW_DEBUG_TRACE=y
CONFIG_CPP=y
CONFIG_STD_CPP17=y
CONFIG_COMP_TENSORFLOW=n
CONFIG_COMP_MULTIBAND_DRC=y
CONFIG_COMP_VOLUME_WINDOWS_FADE=y
CONFIG_SAMPLES=y
CONFIG_SAMPLE_KEYPHRASE=y
CONFIG_FORMAT_CONVERT_HIFI3=n
CONFIG_PCM_CONVERTER_FORMAT_S16LE=y
CONFIG_PCM_CONVERTER_FORMAT_S24LE=y
CONFIG_PCM_CONVERTER_FORMAT_S32LE=y
CONFIG_PCM_CONVERTER_FORMAT_S24_3LE=y

# SOF / infrastructure
CONFIG_AMS=y
CONFIG_IDC_TIMEOUT_US=100000
CONFIG_LP_MEMORY_BANKS=1
CONFIG_HP_MEMORY_BANKS=30

# SOF / loadable modules
CONFIG_INTEL_MODULES=y
CONFIG_LIBRARY_MANAGER=n

# SOF / logging
CONFIG_SOF_LOG_LEVEL_INF=y
CONFIG_LOG_BUFFER_SIZE=32768
CONFIG_MTRACE_LOG_CACHE_BUF_SIZE=32768

# Zephyr / OS features
# note: CONFIG_DEBUG_COREDUMP is enabled for all Intel targets in
# boards/intel_adsp/Kconfig.defconfig; only the backend and dump-amount
# choices have to be selected per board.
CONFIG_DEBUG_COREDUMP_BACKEND_INTEL_ADSP_MEM_WINDOW=y
CONFIG_DEBUG_COREDUMP_MEMORY_DUMP_MIN=y
CONFIG_HEAP_MEM_POOL_SIZE=8192
CONFIG_COMMON_LIBC_MALLOC_ARENA_SIZE=65536

# Zephyr / device drivers
CONFIG_DAI_INIT_PRIORITY=70
CONFIG_DAI_DMIC_HW_IOCLK=38400000
CONFIG_DMA_DW_LLI_POOL_SIZE=100
CONFIG_DMA_DW_HW_LLI=y
CONFIG_DMA_DW_FIFO_PARTITION=y
CONFIG_DMA_INTEL_ADSP_GPDMA_HAS_LLP=y

# Zephyr / power settings
CONFIG_PM_POLICY_CUSTOM=y

# Zephyr / logging
CONFIG_LOG_BACKEND_ADSP=n
CONFIG_LOG_BACKEND_ADSP_MTRACE=y
CONFIG_LOG_FUNC_NAME_PREFIX_ERR=y
CONFIG_LOG_FUNC_NAME_PREFIX_WRN=y
CONFIG_LOG_FUNC_NAME_PREFIX_INF=y
CONFIG_LOG_FUNC_NAME_PREFIX_DBG=y
CONFIG_LOG_TIMESTAMP_64BIT=y
CONFIG_WINSTREAM_CONSOLE=n
```

## app/boards/nano_esp32s3_esp32s3_procpu.conf
```kconfig
# Target Platform & SOF Core
CONFIG_PLATFORM_ESP32S3=y
CONFIG_SOF_FULL_ZEPHYR_APPLICATION=y
CONFIG_ZEPHYR_NATIVE_DRIVERS=y
CONFIG_BUILD_OUTPUT_BIN=y

# Zephyr DAI Drivers for ESP32
CONFIG_DAI=y
CONFIG_DAI_ESPRESSIF_I2S=y
CONFIG_PINCTRL=y
CONFIG_DMA=y
CONFIG_DMA_ESP32_MAX_DESCRIPTOR_NUM=32

# Audio Processing Modules (Fixed-Point S16_LE)
CONFIG_FORMAT_S16LE=y
CONFIG_COMP_VOLUME=y
CONFIG_COMP_USB_AUDIO=y
CONFIG_COMP_BT_AUDIO=n
CONFIG_FILTER_RISCV_SIMD=n
CONFIG_DRC_RISCV_SIMD=n
CONFIG_EQ_IIR_RISCV_SIMD=n
CONFIG_VOLUME_RISCV_SIMD=n
CONFIG_COMP_DRC=n
CONFIG_COMP_IIR=n
CONFIG_COMP_FIR=n
CONFIG_COMP_CROSSOVER=n
CONFIG_COMP_DCBLOCK=n
CONFIG_COMP_MULTIBAND_DRC=n
CONFIG_COMP_TDFB=n

# USB Device Stack Next & UAC2 Class
CONFIG_USB_DEVICE_STACK_NEXT=y
CONFIG_UDC_DRIVER_HIGH_SPEED_SUPPORT_ENABLED=y
CONFIG_USBD_MAX_SPEED_HIGH=y
CONFIG_CDC_ACM_SERIAL_INITIALIZE_AT_BOOT=n
CONFIG_USBD_AUDIO2_CLASS=y
CONFIG_UDC_ENABLE_SOF=y
CONFIG_UDC_DWC2_DMA=y
CONFIG_UDC_BUF_COUNT=64
CONFIG_UDC_BUF_POOL_SIZE=16384

# USB CDC-ACM Virtual Serial Port
CONFIG_USBD_CDC_ACM_CLASS=y
CONFIG_UART_LINE_CTRL=y
CONFIG_UART_INTERRUPT_DRIVEN=y

# USB Device Identification & Hardware Info
CONFIG_HWINFO=y
CONFIG_HWINFO_ESP32=y
CONFIG_SAMPLE_USBD_VID=0x303A
CONFIG_SAMPLE_USBD_PID=0x4003
CONFIG_SAMPLE_USBD_MANUFACTURER="Espressif"
CONFIG_SAMPLE_USBD_PRODUCT="ESP32-S3 USB Audio"

# System Resources & Memory
CONFIG_MAIN_STACK_SIZE=4096
CONFIG_SYSTEM_WORKQUEUE_STACK_SIZE=4096
CONFIG_USBD_THREAD_STACK_SIZE=4096
CONFIG_UDC_DWC2_STACK_SIZE=4096
CONFIG_UDC_WORKQUEUE_STACK_SIZE=4096
CONFIG_ISR_STACK_SIZE=2048
CONFIG_HW_STACK_PROTECTION=n
CONFIG_HEAP_MEM_POOL_SIZE=16384
CONFIG_TICKLESS_KERNEL=n
CONFIG_SYS_CLOCK_TICKS_PER_SEC=1000

# Logging & USB Console
CONFIG_LOG=y
CONFIG_LOG_DEFAULT_LEVEL=3
CONFIG_LOG_MAX_LEVEL=4
CONFIG_SOF_LOG_LEVEL_INF=y
CONFIG_DAI_LOG_LEVEL_INF=y
CONFIG_USBD_UAC2_LOG_LEVEL_INF=y
CONFIG_UDC_DRIVER_LOG_LEVEL_INF=y
CONFIG_LOG_MODE_DEFERRED=y
CONFIG_LOG_BUFFER_SIZE=4096
CONFIG_LOG_MODE_OVERFLOW=y
CONFIG_LOG_BACKEND_UART=y
CONFIG_SHELL_LOG_BACKEND=y
CONFIG_PRINTK=y
CONFIG_LOG_PRINTK=n
CONFIG_EARLY_CONSOLE=n

# Interactive Shell over USB CDC-ACM
CONFIG_SHELL=y
CONFIG_SHELL_STACK_SIZE=8192
CONFIG_SHELL_BACKENDS=y
CONFIG_SHELL_BACKEND_SERIAL=y
CONFIG_SHELL_BACKEND_SERIAL_INTERRUPT_DRIVEN=y
CONFIG_SHELL_PROMPT_UART="sof:~$ "

# SOF Low Latency Scheduler Statistics Logging
CONFIG_SCHEDULE_LL_STATS_LOG=y
CONFIG_SCHEDULE_LL_STATS_LOG_EVERY_OTHER_WINDOW=n
CONFIG_SCHEDULE_LL_STATS_LOG_WINDOW_SIZE=10
```

## app/boards/nrf54l15dk_nrf54l15_cpuapp.conf
```kconfig
# Target Platform & SOF Core
CONFIG_PLATFORM_NORDIC=y
CONFIG_PLATFORM_NRF54L15=y
CONFIG_SOF_FULL_ZEPHYR_APPLICATION=y
CONFIG_ZEPHYR_NATIVE_DRIVERS=y
CONFIG_SYS_HEAP_BIG_ONLY=y
CONFIG_BUILD_OUTPUT_HEX=y
CONFIG_BUILD_OUTPUT_BIN=y

# Audio Processing Modules & ARM SIMD Optimizations
CONFIG_COMP_VOLUME=y
CONFIG_VOLUME_ARM_SIMD=y
CONFIG_COMP_IIR=y
CONFIG_EQ_IIR_ARM_SIMD=y
CONFIG_FILTER_ARM_SIMD=y
CONFIG_COMP_FIR=y
CONFIG_COMP_DRC=y
CONFIG_DRC_ARM_SIMD=y
CONFIG_COMP_CROSSOVER=y
CONFIG_COMP_DCBLOCK=y
CONFIG_DCBLOCK_ARM_SIMD=y
CONFIG_COMP_MULTIBAND_DRC=y
CONFIG_COMP_TONE=y
CONFIG_COMP_LEVEL_MULTIPLIER=y
CONFIG_COMP_SEL=y
CONFIG_COMP_MUX=y
CONFIG_COMP_MIXER=y
CONFIG_MIXER_ARM_SIMD=y
CONFIG_FORMAT_CONVERT_ARM_SIMD=y
CONFIG_COMP_USB_AUDIO=y
CONFIG_COMP_BT_AUDIO=y

# Bluetooth Stack & Central / Observer Role
CONFIG_BT=y
CONFIG_BT_OBSERVER=y
CONFIG_BT_CENTRAL=y
CONFIG_BT_GATT_CLIENT=y
CONFIG_BT_LL_SW_SPLIT=y
CONFIG_BT_EXT_ADV=y
CONFIG_BT_CTLR_ADV_EXT=y
CONFIG_BT_CTLR_ADVANCED_FEATURES=y
CONFIG_BT_CTLR_XTAL_ADVANCED=n
CONFIG_BT_CTLR_ASSERT_OVERHEAD_START=n
CONFIG_BT_L2CAP_TX_MTU=247
CONFIG_BT_BUF_ACL_RX_SIZE=251
CONFIG_BT_BUF_ACL_TX_SIZE=251
CONFIG_BT_MAX_CONN=2
CONFIG_BT_MAX_PAIRED=2

# Hardware FPU & ARM DSP
CONFIG_FPU=y

# System Resources & Memory (Lean footprint for 256KB RAM)
CONFIG_MAIN_STACK_SIZE=4096
CONFIG_SYSTEM_WORKQUEUE_STACK_SIZE=4096
CONFIG_ISR_STACK_SIZE=2048
CONFIG_HW_STACK_PROTECTION=n
CONFIG_HEAP_MEM_POOL_SIZE=8192
CONFIG_TICKLESS_KERNEL=n
CONFIG_SYS_CLOCK_TICKS_PER_SEC=1000

# Logging & UART Console
CONFIG_LOG=y
CONFIG_LOG_DEFAULT_LEVEL=3
CONFIG_LOG_MAX_LEVEL=4
CONFIG_SOF_LOG_LEVEL_INF=y
CONFIG_LOG_MODE_DEFERRED=y
CONFIG_LOG_BUFFER_SIZE=2048
CONFIG_LOG_MODE_OVERFLOW=y
CONFIG_LOG_BACKEND_UART=y
CONFIG_PRINTK=y
CONFIG_LOG_PRINTK=y
CONFIG_EARLY_CONSOLE=y
```

## app/boards/rpi_pico2_rp2350a_m33_0.conf
```kconfig
# Target Platform & SOF Core
CONFIG_PLATFORM_RP2350=y
CONFIG_SOF_FULL_ZEPHYR_APPLICATION=y
CONFIG_ZEPHYR_NATIVE_DRIVERS=y
CONFIG_IPC_MAJOR_4=y
CONFIG_COMP_BASEFW_IPC4=n
CONFIG_CROSS_CORE_STREAM=n
CONFIG_STATIC_PIPELINE=y
CONFIG_SYS_HEAP_BIG_ONLY=y
CONFIG_BUILD_OUTPUT_UF2=y
CONFIG_BUILD_OUTPUT_BIN=y

# Audio Processing Modules & ARM SIMD Optimizations
CONFIG_COMP_VOLUME=y
CONFIG_VOLUME_ARM_SIMD=y
CONFIG_COMP_IIR=y
CONFIG_EQ_IIR_ARM_SIMD=y
CONFIG_FILTER_ARM_SIMD=y
CONFIG_COMP_FIR=n
CONFIG_COMP_DRC=y
CONFIG_DRC_ARM_SIMD=y
CONFIG_COMP_CROSSOVER=n
CONFIG_COMP_DCBLOCK=n
CONFIG_COMP_MULTIBAND_DRC=n
CONFIG_COMP_TDFB=n
CONFIG_COMP_USB_AUDIO=y
CONFIG_COMP_TONE=n

# USB Device Stack Next & UAC2 Class
CONFIG_USB_DEVICE_STACK_NEXT=y
CONFIG_UDC_DRIVER_HIGH_SPEED_SUPPORT_ENABLED=n
CONFIG_USBD_MAX_SPEED_FULL=y
CONFIG_CDC_ACM_SERIAL_INITIALIZE_AT_BOOT=n
CONFIG_USBD_AUDIO2_CLASS=y
CONFIG_UDC_ENABLE_SOF=n
CONFIG_UDC_BUF_COUNT=16
CONFIG_UDC_BUF_POOL_SIZE=4096
CONFIG_UDC_RPI_PICO_STACK_SIZE=2048
CONFIG_UDC_RPI_PICO_THREAD_PRIORITY=8
CONFIG_LL_THREAD_PRIORITY=0

# C Library (Picolibc required for Cortex-M33 USB buffer alignment)
CONFIG_PICOLIBC=y
CONFIG_MINIMAL_LIBC=n

# USB Device Identification
CONFIG_SAMPLE_USBD_VID=0x2E8A
CONFIG_SAMPLE_USBD_PID=0x000A
CONFIG_SAMPLE_USBD_MANUFACTURER="Raspberry Pi"
CONFIG_SAMPLE_USBD_PRODUCT="SOF RP2350 Audio"

# System Resources & Memory
CONFIG_MAIN_STACK_SIZE=8192
CONFIG_SYSTEM_WORKQUEUE_STACK_SIZE=4096
CONFIG_USBD_THREAD_STACK_SIZE=4096
CONFIG_ISR_STACK_SIZE=4096
CONFIG_HW_STACK_PROTECTION=n
CONFIG_HEAP_MEM_POOL_SIZE=16384
CONFIG_TICKLESS_KERNEL=n
CONFIG_SYS_CLOCK_TICKS_PER_SEC=1000

# Logging & Console
CONFIG_LOG=y
CONFIG_LOG_DEFAULT_LEVEL=3
CONFIG_LOG_MAX_LEVEL=4
CONFIG_SOF_LOG_LEVEL_INF=y
CONFIG_USBD_UAC2_LOG_LEVEL_INF=y
CONFIG_UDC_DRIVER_LOG_LEVEL_INF=y
CONFIG_LOG_MODE_DEFERRED=y
CONFIG_LOG_BUFFER_SIZE=4096
CONFIG_LOG_MODE_OVERFLOW=y
CONFIG_LOG_BACKEND_UART=n
CONFIG_PRINTK=n
CONFIG_LOG_PRINTK=n
CONFIG_EARLY_CONSOLE=n

# SOF Low Latency Scheduler Statistics Logging
CONFIG_SCHEDULE_LL_STATS_LOG=n
```

## src/Kconfig
```kconfig
# SPDX-License-Identifier: BSD-3-Clause

rsource "arch/Kconfig"

rsource "platform/Kconfig"

rsource "audio/Kconfig"

rsource "trace/Kconfig"

rsource "samples/Kconfig"

rsource "schedule/Kconfig"
rsource "schedule/Kconfig.threads_prio"

rsource "kernel/Kconfig"

rsource "ipc/Kconfig"

rsource "math/Kconfig"

rsource "debug/debug_stream/Kconfig"

rsource "debug/tester/Kconfig"
```

## src/audio/acompressor/Kconfig
```kconfig
# SPDX-License-Identifier: BSD-3-Clause

config COMP_ACOMPRESSOR
	tristate "FFmpeg Dynamic Range Compressor (acompressor) module"
	default n
	help
	  Select to enable the dynamic range compressor module.
	  Provides downward dynamic range compression with configurable attack/release.

if COMP_ACOMPRESSOR

config COMP_ACOMPRESSOR_STUB
	bool "Build with pass-through stub backend"
	default n
	help
	  Select to build with the pass-through stub backend instead of real acompressor.

config ACOMPRESSOR_ATTACK_MS
	int "Default attack time (ms)"
	default 20
	range 1 500
	help
	  Attack time in milliseconds (default 20 ms).

config ACOMPRESSOR_RELEASE_MS
	int "Default release time (ms)"
	default 250
	range 10 2000
	help
	  Release time in milliseconds (default 250 ms).

config ACOMPRESSOR_RATIO
	int "Default compression ratio"
	default 3
	range 1 20
	help
	  Compression ratio (e.g. 3 for 3:1).

endif # COMP_ACOMPRESSOR
```

## src/audio/alimiter/Kconfig
```kconfig
# SPDX-License-Identifier: BSD-3-Clause

config COMP_ALIMITER
	tristate "FFmpeg Lookahead Peak Limiter (alimiter) module"
	default n
	help
	  Select to enable the lookahead peak limiter module.
	  Prevents clipping and protects downstream DAC/speakers using a smooth lookahead window.

if COMP_ALIMITER

config COMP_ALIMITER_STUB
	bool "Build with pass-through stub backend"
	default n
	help
	  Select to build with the pass-through stub backend instead of the real limiter.

config ALIMITER_ATTACK_MS
	int "Default lookahead attack time (ms)"
	default 5
	range 1 10
	help
	  Lookahead buffer window in milliseconds (default 5 ms).

config ALIMITER_RELEASE_MS
	int "Default release recovery time (ms)"
	default 50
	range 5 500
	help
	  Linear gain release recovery time in milliseconds (default 50 ms).

endif # COMP_ALIMITER
```
